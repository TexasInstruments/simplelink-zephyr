## CMakeLists.txt
```
cmake_minimum_required(VERSION 3.20.0)
find_package(Zephyr REQUIRED HINTS $ENV{ZEPHYR_BASE})
project(cc35xx_pm_wifi)

target_sources(app PRIVATE src/main.c)
```

## Kconfig
```
choice PM_WIFI_STRATEGY
	prompt "cc35xx pm_wifi power-save strategy"
	default PM_WIFI_STRATEGY_DTIM

config PM_WIFI_STRATEGY_NONE
	bool "no power save"

config PM_WIFI_STRATEGY_BEACON
	bool "wake every beacon"

config PM_WIFI_STRATEGY_DTIM
	bool "wake every DTIM"

config PM_WIFI_STRATEGY_LONG_DOZE
	bool "wake every N DTIMs"

endchoice

choice PM_WIFI_LOW_POWER_MODE
	prompt "cc35xx pm_wifi low-power mode"
	default PM_WIFI_LOW_POWER_SUSPEND

config PM_WIFI_LOW_POWER_PS
	bool "WiFi firmware power save only"
	help
	  Keep the host SoC awake and only switch the CC35XX firmware to WiFi
	  power save through NET_REQUEST_WIFI_PS.

config PM_WIFI_LOW_POWER_SUSPEND
	bool "WiFi power save plus host standby"
	help
	  Enable WiFi power save, then release PM locks and enter host standby
	  during the sleep window. This is the lowest-power mode.

endchoice

config PM_WIFI_SSID
	string "WiFi SSID"
	default "ssid_name"
	help
	  SSID used by the CC35xx WiFi PM sample.

config PM_WIFI_PSK
	string "WiFi password"
	default "password"
	help
	  WPA/WPA2/WPA3 passphrase used by the CC35xx WiFi PM sample.

config PM_WIFI_LONG_DOZE_DTIMS
	int "DTIM count for LONG_DOZE strategy"
	depends on PM_WIFI_STRATEGY_LONG_DOZE
	range 2 20
	default 5

config PM_WIFI_NET_POWER_MANAGEMENT
	bool
	default y if PM_WIFI_LOW_POWER_SUSPEND
	select NET_POWER_MANAGEMENT if PM_DEVICE

source "Kconfig.zephyr"
```

## sample.yaml
```
sample:
  name: CC35xx WiFi power management
  description: Demonstrates CC35xx WiFi power save and host standby.
tests:
  sample.boards.ti.cc35xx.pm_wifi:
    platform_allow:
      - lp_em_cc35x1
    tags:
      - pm
      - wifi
    harness: console
    harness_config:
      type: one_line
      regex:
        - "pm_wifi: low-power mode=.*"
```

## prj.conf
```kconfig
CONFIG_PM=y
CONFIG_PM_DEVICE=y
CONFIG_CC35XX_RTC_TIMER=y
CONFIG_PM_WIFI_STRATEGY_DTIM=y

CONFIG_NETWORKING=y
CONFIG_NET_IPV4=y
CONFIG_NET_IPV6=n
CONFIG_NET_TCP=n
CONFIG_NET_UDP=y
CONFIG_NET_DHCPV4=y
CONFIG_NET_L2_ETHERNET=y
CONFIG_NET_SOCKETS=n
CONFIG_NET_PKT_RX_COUNT=10
CONFIG_NET_PKT_TX_COUNT=10
CONFIG_NET_BUF_RX_COUNT=20
CONFIG_NET_BUF_TX_COUNT=20
CONFIG_NET_MAX_CONN=4
CONFIG_NET_MAX_CONTEXTS=10

CONFIG_WIFI=y
CONFIG_WIFI_TI_CC3XXX=y

CONFIG_HEAP_MEM_POOL_SIZE=80000
CONFIG_MAIN_STACK_SIZE=60000
CONFIG_NET_TX_STACK_SIZE=2048
CONFIG_NET_RX_STACK_SIZE=2048
CONFIG_DYNAMIC_THREAD_PREFER_POOL=y
CONFIG_DYNAMIC_THREAD_POOL_SIZE=3
CONFIG_DYNAMIC_THREAD_STACK_SIZE=8192

CONFIG_SERIAL=y
CONFIG_UART_CC35XX=y
CONFIG_CONSOLE=y
CONFIG_UART_CONSOLE=y
CONFIG_PRINTK=y
CONFIG_PRINTK_SYNC=y

CONFIG_SHELL=n
CONFIG_SHELL_BACKEND_SERIAL=n
CONFIG_UART_CONSOLE_INPUT_EXPIRED=n

CONFIG_LOG=n
CONFIG_NET_LOG=n
```

## boards/lp_em_cc35x1.overlay
```dts
&wlan0 {
	status = "okay";
};

&flash1 {
	status = "okay";
};
```

## src/main.c
```c
/*
 * Copyright (c) 2026 Conclusive Engineering Sp. z o.o.
 *
 * SPDX-License-Identifier: Apache-2.0
 */

#include <zephyr/kernel.h>
#include <zephyr/init.h>
#include <zephyr/logging/log.h>
#include <zephyr/net/net_if.h>
#include <zephyr/net/net_mgmt.h>
#include <zephyr/net/net_ip.h>
#include <zephyr/net/dhcpv4.h>
#include <zephyr/net/wifi_mgmt.h>
#include <zephyr/pm/pm.h>
#include <zephyr/pm/policy.h>
#include <zephyr/sys/printk.h>

#define WIFI_SSID CONFIG_PM_WIFI_SSID
#define WIFI_PSK  CONFIG_PM_WIFI_PSK
#define WIFI_ON_TIME_SECONDS  30
#define WIFI_OFF_TIME_SECONDS 5

static K_SEM_DEFINE(wifi_connected_sem, 0, 1);
static K_SEM_DEFINE(ipv4_acquired_sem, 0, 1);

static bool wifi_link_up;

/* Keep standby locked until the DHCP address is acquired. */
static int pm_wifi_boot_lock(void)
{
	pm_policy_state_lock_get(PM_STATE_STANDBY, PM_ALL_SUBSTATES);
	return 0;
}
SYS_INIT(pm_wifi_boot_lock, PRE_KERNEL_1, 0);

static struct net_mgmt_event_callback wifi_cb;
static struct net_mgmt_event_callback ipv4_cb;

static void wifi_event_handler(struct net_mgmt_event_callback *cb,
			       uint32_t mgmt_event, struct net_if *iface)
{
	const struct wifi_status *status = cb->info;

	switch (mgmt_event) {
	case NET_EVENT_WIFI_CONNECT_RESULT:
		if (status && status->status == 0) {
			wifi_link_up = true;
			printk("wifi: connected\n");
			k_sem_give(&wifi_connected_sem);
		} else {
			printk("wifi: connect failed %d\n",
			       status ? status->status : -1);
		}
		break;
	case NET_EVENT_WIFI_DISCONNECT_RESULT:
		wifi_link_up = false;
		printk("wifi: disconnected\n");
		break;
	default:
		break;
	}
}

static void ipv4_event_handler(struct net_mgmt_event_callback *cb,
			       uint32_t mgmt_event, struct net_if *iface)
{
	char addr[NET_IPV4_ADDR_LEN];

	if (mgmt_event != NET_EVENT_IPV4_DHCP_BOUND) {
		return;
	}

	for (int i = 0; i < NET_IF_MAX_IPV4_ADDR; i++) {
		struct net_if_addr_ipv4 *if_addr =
			&iface->config.ip.ipv4->unicast[i];

		if (if_addr->ipv4.addr_type != NET_ADDR_DHCP ||
		    if_addr->ipv4.address.in_addr.s_addr == 0) {
			continue;
		}

		net_addr_ntop(AF_INET, &if_addr->ipv4.address.in_addr,
			      addr, sizeof(addr));
		printk("wifi: ipv4 acquired %s\n", addr);
		k_sem_give(&ipv4_acquired_sem);
		return;
	}
}

static void wifi_events_init(void)
{
	net_mgmt_init_event_callback(&wifi_cb, wifi_event_handler,
				     NET_EVENT_WIFI_CONNECT_RESULT |
					     NET_EVENT_WIFI_DISCONNECT_RESULT);
	net_mgmt_add_event_callback(&wifi_cb);

	net_mgmt_init_event_callback(&ipv4_cb, ipv4_event_handler,
				     NET_EVENT_IPV4_DHCP_BOUND);
	net_mgmt_add_event_callback(&ipv4_cb);
}

static int wifi_connect(void)
{
	struct net_if *iface = net_if_get_first_wifi();
	struct wifi_connect_req_params params = {
		.ssid = WIFI_SSID,
		.ssid_length = sizeof(WIFI_SSID) - 1,
		.sae_password = WIFI_PSK,
		.sae_password_length = sizeof(WIFI_PSK) - 1,
		.channel = WIFI_CHANNEL_ANY,
		.security = WIFI_SECURITY_TYPE_SAE,
		.mfp = WIFI_MFP_REQUIRED,
	};

	if (!iface) {
		printk("wifi: no iface\n");
		return -ENODEV;
	}

	k_sem_reset(&wifi_connected_sem);

	printk("wifi: connecting to \"%s\"\n", WIFI_SSID);
	return net_mgmt(NET_REQUEST_WIFI_CONNECT, iface, &params,
			sizeof(params));
}

static int wifi_connect_wait(struct net_if *iface)
{
	for (int attempt = 0; attempt < 3; attempt++) {
		if (wifi_connect() < 0) {
			printk("wifi: connect request failed\n");
			return -EIO;
		}

		if (k_sem_take(&wifi_connected_sem, K_SECONDS(30)) == 0) {
			goto connected;
		}

		printk("wifi: connect timeout\n");
	}

	return -ETIMEDOUT;

connected:
	return 0;
}

static int wifi_wait_for_ipv4(struct net_if *iface)
{
	for (int i = 0; i < NET_IF_MAX_IPV4_ADDR; i++) {
		struct net_if_addr_ipv4 *if_addr =
			&iface->config.ip.ipv4->unicast[i];

		if (if_addr->ipv4.addr_type == NET_ADDR_DHCP &&
		    if_addr->ipv4.addr_state == NET_ADDR_PREFERRED &&
		    if_addr->ipv4.address.in_addr.s_addr != 0) {
			return 0;
		}
	}

	k_sem_reset(&ipv4_acquired_sem);
	net_dhcpv4_stop(iface);
	net_dhcpv4_start(iface);

	if (k_sem_take(&ipv4_acquired_sem, K_SECONDS(30)) == 0) {
		return 0;
	}

	printk("wifi: ipv4 timeout\n");
	return -ETIMEDOUT;
}

static int wifi_reconnect(struct net_if *iface)
{
	int ret;

	ret = wifi_connect_wait(iface);
	if (ret < 0) {
		return ret;
	}

	return wifi_wait_for_ipv4(iface);
}

static void wifi_configure_power_save(struct net_if *iface)
{
	struct wifi_ps_params ps_mode = {
		.type = WIFI_PS_PARAM_WAKEUP_MODE,
#if defined(CONFIG_PM_WIFI_STRATEGY_BEACON)
		.wakeup_mode = WIFI_PS_WAKEUP_MODE_LISTEN_INTERVAL,
#else
		.wakeup_mode = WIFI_PS_WAKEUP_MODE_DTIM,
#endif
	};

	int mode = net_mgmt(NET_REQUEST_WIFI_PS, iface, &ps_mode, sizeof(ps_mode));

	printk("wifi: PM strategy=%s listen=%u mode_rc=%d\n",
	       IS_ENABLED(CONFIG_PM_WIFI_STRATEGY_BEACON) ? "BEACON" :
	       IS_ENABLED(CONFIG_PM_WIFI_STRATEGY_LONG_DOZE) ? "LONG_DOZE" :
							      "DTIM",
	       1U, mode);
#if defined(CONFIG_PM_WIFI_STRATEGY_NONE)
	struct wifi_ps_params ps_state = {
		.type = WIFI_PS_PARAM_STATE,
		.enabled = WIFI_PS_DISABLED,
	};

	int ps = net_mgmt(NET_REQUEST_WIFI_PS, iface, &ps_state, sizeof(ps_state));

	printk("wifi: PM strategy=NONE rc=%d\n", ps);
#endif
}

static int wifi_apply_power_save(struct net_if *iface, bool enable)
{
	struct wifi_ps_params ps_state = {
		.type = WIFI_PS_PARAM_STATE,
		.enabled = enable ? WIFI_PS_ENABLED : WIFI_PS_DISABLED,
	};
	int ret = net_mgmt(NET_REQUEST_WIFI_PS, iface, &ps_state, sizeof(ps_state));

	printk("wifi: PS %s rc=%d\n", enable ? "enabled" : "disabled", ret);
	return ret;
}

static int pm_wifi_sleep_window(struct net_if *iface)
{
	if (IS_ENABLED(CONFIG_PM_WIFI_LOW_POWER_SUSPEND)) {
#if defined(CONFIG_NET_POWER_MANAGEMENT)
		int ret;

		ret = net_if_suspend(iface);
		if (ret < 0 && ret != -EALREADY) {
			return ret;
		}
#endif

		pm_policy_state_lock_put(PM_STATE_STANDBY, PM_ALL_SUBSTATES);
		k_msleep(WIFI_OFF_TIME_SECONDS * MSEC_PER_SEC);
		pm_policy_state_lock_get(PM_STATE_STANDBY, PM_ALL_SUBSTATES);

#if defined(CONFIG_NET_POWER_MANAGEMENT)
		ret = net_if_resume(iface);
		if (ret < 0 && ret != -EALREADY) {
			return ret;
		}
#endif
	} else {
		k_msleep(WIFI_OFF_TIME_SECONDS * MSEC_PER_SEC);
	}

	return 0;
}

int main(void)
{
	struct net_if *iface = net_if_get_first_wifi();
	uint32_t cycle = 0;
	int ret;

	printk("pm_wifi sample: boot\n");

	if (!iface) {
		printk("wifi: iface not ready\n");
		return -ENODEV;
	}

	wifi_events_init();

	ret = wifi_reconnect(iface);
	if (ret < 0) {
		return ret;
	}

	wifi_configure_power_save(iface);

	printk("pm_wifi: low-power mode=%s\n",
	       IS_ENABLED(CONFIG_PM_WIFI_LOW_POWER_SUSPEND) ? "suspend" : "wifi-ps");

	if (IS_ENABLED(CONFIG_PM_WIFI_LOW_POWER_PS)) {
		ret = wifi_apply_power_save(iface, true);
		if (ret < 0 && ret != -EALREADY) {
			return ret;
		}

		printk("pm_wifi: PS enabled, idle\n");
		while (1) {
			k_sleep(K_FOREVER);
		}
	}

	printk("pm_wifi: entering %ds active / %ds sleep loop\n",
	       WIFI_ON_TIME_SECONDS, WIFI_OFF_TIME_SECONDS);

	while (1) {
		printk("pm_wifi[%u]: wifi sleep for %ds\n",
		       cycle, WIFI_OFF_TIME_SECONDS);
		if (!wifi_link_up) {
			printk("pm_wifi[%u]: reconnecting after disconnect\n", cycle);
			ret = wifi_reconnect(iface);
			if (ret < 0) {
				printk("wifi: reconnect failed %d\n", ret);
				return ret;
			}
			wifi_configure_power_save(iface);
			continue;
		}

		ret = wifi_apply_power_save(iface, true);
		if (ret < 0 && ret != -EALREADY) {
			cycle++;
			continue;
		}

		ret = pm_wifi_sleep_window(iface);
		if (ret < 0) {
			printk("wifi: sleep window failed %d\n", ret);
		}

		ret = wifi_apply_power_save(iface, false);
		if (ret < 0 && ret != -EALREADY) {
			printk("wifi: PS restore failed %d\n", ret);
		}

		if (!wifi_link_up) {
			printk("pm_wifi[%u]: reconnecting after wake\n", cycle);
			ret = wifi_reconnect(iface);
			if (ret < 0) {
				printk("wifi: reconnect failed %d\n", ret);
				return ret;
			}
		}

		printk("pm_wifi[%u]: active for %ds\n",
		       cycle, WIFI_ON_TIME_SECONDS);
		k_msleep(WIFI_ON_TIME_SECONDS * MSEC_PER_SEC);

		cycle++;
	}
	return 0;
}
```
