&lgpt0 {
	clk-prescale = <256>;
	status = "okay";
};

&lgpt1 {
	clk-prescale = <256>;
	status = "okay";
};

&lgpt2 {
	clk-prescale = <256>;
	status = "okay";
};

&lgpt3 {
	clk-prescale = <256>;
	status = "okay";
};
