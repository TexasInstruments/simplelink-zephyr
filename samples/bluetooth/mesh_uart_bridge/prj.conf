## CMakeLists.txt
```
# SPDX-License-Identifier: Apache-2.0

cmake_minimum_required(VERSION 3.20.0)
set(QEMU_EXTRA_FLAGS -s)

find_package(Zephyr REQUIRED HINTS $ENV{ZEPHYR_BASE})
project(mesh)

target_sources(app PRIVATE
  src/main.c
  src/board.c
  src/uart_bridge_model.c
)

target_include_directories(app PRIVATE include)

if (CONFIG_BUILD_WITH_TFM)
  target_include_directories(app PRIVATE
    $<TARGET_PROPERTY:tfm,TFM_BINARY_DIR>/api_ns/interface/include
  )
endif()
```

## Kconfig
```
#
# Copyright (c) 2025, Texas Instruments Incorporated
#
# SPDX-License-Identifier: Apache-2.0
#

source "Kconfig.zephyr"

menu "Texas Instruments Bluetooth Mesh UART Bridge Sample"

config BT_MESH_UART_BRIDGE_PAYLOAD_LEN
    int "Maximum payload length for UART Bridge model to be sent through mesh"
    default 100
    range 1 377
    help
      Maximum payload length for UART Bridge model to be sent through mesh. The
      maximum access layer payload length is 384. However, that includes the
      opcode (3 bytes) and the transMIC (4 bytes). These bytes are subtracted
      from the maximum access layer payload length to get the maximum UART Bridge
      payload length of 377 bytes.

endmenu
```

## sample.yaml
```
sample:
  name: Bluetooth Mesh UART Bridge
tests:
  sample.bluetooth.mesh_uart_bridge:
    harness: bluetooth
    platform_allow:
      - lp_em_cc2340r53
      - lp_em_cc2340r53_wcsp
      - lp_em_cc2340r5moda
      - lp_em_cc2745r10_q1/cc2745r10_q1
      - lp_em_cc2745r10_q1/cc2755r10
      - lp_em_cc2755p10
      - lp_em_cc2755p20
    integration_platforms:
      - qemu_x86
    tags: bluetooth
```

## prj.conf
```kconfig
CONFIG_SYSTEM_WORKQUEUE_STACK_SIZE=2048

CONFIG_BT_SETTINGS=y
CONFIG_FLASH=y
CONFIG_FLASH_MAP=y
CONFIG_NVS=y
CONFIG_SETTINGS=y
CONFIG_HWINFO=y

CONFIG_BT=y
CONFIG_BT_L2CAP_TX_BUF_COUNT=5
CONFIG_BT_PERIPHERAL=y
CONFIG_BT_OBSERVER=y
CONFIG_BT_BROADCASTER=y

CONFIG_BT_CTLR_DUP_FILTER_LEN=0
CONFIG_BT_CTLR_LE_ENC=n
CONFIG_BT_CTLR_LE_PING=n
CONFIG_BT_DATA_LEN_UPDATE=n
CONFIG_BT_PHY_UPDATE=n
CONFIG_BT_CTLR_MIN_USED_CHAN=n
CONFIG_BT_CTLR_PRIVACY=n
CONFIG_BT_CTLR_CHAN_SEL_2=n

CONFIG_BT_MESH=y
CONFIG_BT_MESH_MODEL_EXTENSIONS=y
CONFIG_BT_MESH_RELAY=y
CONFIG_BT_MESH_FRIEND=y
CONFIG_BT_MESH_PB_GATT=y
CONFIG_BT_MESH_PB_ADV=y
CONFIG_BT_MESH_GATT_PROXY=y
CONFIG_BT_MESH_RX_SEG_MAX=32
CONFIG_BT_MESH_TX_SEG_MAX=32

CONFIG_BT_MESH_SUBNET_COUNT=2
CONFIG_BT_MESH_APP_KEY_COUNT=2
CONFIG_BT_MESH_MODEL_GROUP_COUNT=2
CONFIG_BT_MESH_LABEL_COUNT=3

CONFIG_BT_DEVICE_NAME="Zephyr Mesh UART Bridge"
CONFIG_SHELL=y
CONFIG_LOG_CMDS=y

CONFIG_BT_MESH_RPR_SRV=y
```

## src/main.c
```c
/* main.c - Application main entry point */

/*
 * Copyright (c) 2017 Intel Corporation
 * Copyright (c) 2025 Texas Instruments Incorporated
 *
 * SPDX-License-Identifier: Apache-2.0
 */

#include <zephyr/sys/printk.h>

#include <zephyr/settings/settings.h>
#include <zephyr/devicetree.h>
#include <zephyr/device.h>
#include <zephyr/drivers/gpio.h>
#include <zephyr/drivers/hwinfo.h>
#include <zephyr/sys/byteorder.h>

#include <zephyr/bluetooth/bluetooth.h>
#include <zephyr/bluetooth/mesh.h>

#include <zephyr/logging/log.h>
#include <zephyr/drivers/uart.h>
#include <zephyr/shell/shell.h>
#include <zephyr/shell/shell_uart.h>

#include "board.h"
#include "uart_bridge_model.h"

static const struct shell *uart_shell;

static void attention_on(const struct bt_mesh_model *mod)
{
	board_led_set(true);
}

static void attention_off(const struct bt_mesh_model *mod)
{
	board_led_set(false);
}

static int handle_payload(const struct bt_mesh_uart_bridge *uart_bridge,
						  struct bt_mesh_msg_ctx *ctx,
						  const uint8_t *payload)
{
	uint16_t addr = bt_mesh_model_elem(uart_bridge->model)->rt->addr;

	/* Do not print the payload if it came from this device */
	if (addr == ctx->addr)
    {
        return 0;
    }

	shell_print(uart_shell, "[0x%04x]: %s", ctx->addr, payload);

	return 0;
}

static const struct bt_mesh_health_srv_cb health_cb = {
	.attn_on = attention_on,
	.attn_off = attention_off,
};

static struct bt_mesh_health_srv health_srv = {
	.cb = &health_cb,
};

static const struct bt_mesh_uart_bridge_cb uart_bridge_cb = {
	.payload = handle_payload,
};

static struct bt_mesh_uart_bridge uart_bridge = {
	.cb = &uart_bridge_cb,
};

BT_MESH_HEALTH_PUB_DEFINE(health_pub, 0);


/* This application only needs one element to contain its models */
static const struct bt_mesh_model models[] = {
	BT_MESH_MODEL_CFG_SRV,
	BT_MESH_MODEL_HEALTH_SRV(&health_srv, &health_pub),
	BT_MESH_MODEL_RPR_SRV,
};

/* Vendor models */
static const struct bt_mesh_model vnd_models[] = {
	BT_MESH_MODEL_UART_BRIDGE(&uart_bridge)
};

static const struct bt_mesh_elem elements[] = {
	BT_MESH_ELEM(0, models, vnd_models)
};

static const struct bt_mesh_comp comp = {
	.cid = CONFIG_BT_COMPANY_ID,
	.elem = elements,
	.elem_count = ARRAY_SIZE(elements),
};

/* Provisioning */

static int output_number(bt_mesh_output_action_t action, uint32_t number)
{
	printk("OOB Number: %u\n", number);

	board_output_number(action, number);

	return 0;
}

static void prov_complete(uint16_t net_idx, uint16_t addr)
{
	board_prov_complete();
}

static void prov_reset(void)
{
	bt_mesh_prov_enable(BT_MESH_PROV_ADV | BT_MESH_PROV_GATT);
}

static uint8_t dev_uuid[16];

static const struct bt_mesh_prov prov = {
	.uuid = dev_uuid,
	.output_size = 4,
	.output_actions = BT_MESH_DISPLAY_NUMBER,
	.output_number = output_number,
	.complete = prov_complete,
	.reset = prov_reset,
};

static void bt_ready(int err)
{
	if (err) {
		printk("Bluetooth init failed (err %d)\n", err);
		return;
	}

	printk("Bluetooth initialized\n");

	err = bt_mesh_init(&prov, &comp);
	if (err) {
		printk("Initializing mesh failed (err %d)\n", err);
		return;
	}

	if (IS_ENABLED(CONFIG_SETTINGS)) {
		settings_load();
	}

	/* This will be a no-op if settings_load() loaded provisioning info */
	bt_mesh_prov_enable(BT_MESH_PROV_ADV | BT_MESH_PROV_GATT);

	printk("Mesh initialized\n");
}

/* UART shell command callbacks */
static int cmd_bridge(const struct shell *sh, size_t argc, char **argv)
{
	if (argc == 1) {
		shell_help(sh);
		return 1;
	}
	return -EINVAL;
}

static int cmd_payload_send(const struct shell *sh, size_t argc, char **argv)
{
	uint16_t addr = bt_mesh_model_elem(uart_bridge.model)->rt->addr;
	shell_print(sh, "[0x%04x]: %s", addr, argv[1]);

	return bt_mesh_uart_bridge_payload_send(uart_bridge.model, argv[1]);
}

/* UART shell commands */
SHELL_STATIC_SUBCMD_SET_CREATE(bridge_cmds,
	SHELL_CMD_ARG(payload, NULL, "Send payload", cmd_payload_send, 1, 1),
	SHELL_SUBCMD_SET_END
);

SHELL_CMD_ARG_REGISTER(bridge, &bridge_cmds,
					   "Bluetooth Mesh UART Bridge commands",
					   cmd_bridge, 1, 1);

int main(void)
{
	int err = -1;

	printk("Initializing...\n");

	if (IS_ENABLED(CONFIG_HWINFO)) {
		err = hwinfo_get_device_id(dev_uuid, sizeof(dev_uuid));
	}

	if (err < 0) {
		dev_uuid[0] = 0xdd;
		dev_uuid[1] = 0xdd;
	}

	err = board_init();
	if (err) {
		printk("Board init failed (err: %d)\n", err);
		return 0;
	}

	uart_shell = shell_backend_uart_get_ptr();
	if (!uart_shell) {
		printk("UART shell backend not available\n");
		return 0;
	}

	/* Initialize the Bluetooth Subsystem */
	err = bt_enable(bt_ready);
	if (err) {
		printk("Bluetooth init failed (err %d)\n", err);
	}

	return 0;
}
```

## include/uart_bridge_model.h
```c
/*
 * Copyright (c) 2025, Texas Instruments Incorporated
 *
 * SPDX-License-Identifier: Apache-2.0
 */

#ifndef UART_BRIDGE_MODEL_H
#define UART_BRIDGE_MODEL_H

#include <zephyr/bluetooth/mesh.h>

#ifdef __cplusplus
extern "C" {
#endif

/** UART Bridge Model ID */
#define BT_MESH_UART_BRIDGE_VENDOR_MODEL_ID     0x0010

/** UART Bridge Model Op Code Size */
#define BT_MESH_UART_BRIDGE_OP_CODE_SIZE        3
/** UART Bridge Model Payload Op Code */
#define BT_MESH_UART_BRIDGE_OP_PAYLOAD          BT_MESH_MODEL_OP_3(0x01, \
                                                CONFIG_BT_COMPANY_ID)


/** UART Bridge Model Payload minimum length in bytes */
#define BT_MESH_UART_BRIDGE_PAYLOAD_MINLEN      1
/** UART Bridge Model Payload maximum length in bytes */
#define BT_MESH_UART_BRIDGE_PAYLOAD_MAXLEN      MIN(BT_MESH_TX_SDU_MAX, \
                                                BT_MESH_RX_SDU_MAX)     \
                                                - BT_MESH_MIC_SHORT     \
                                                - BT_MESH_UART_BRIDGE_OP_CODE_SIZE

/**
 * @brief UART Bridge Model composition data entry
 *
 * @param uart_bridge Pointer to the bt_mesh_uart_bridge instance.
*/
#define BT_MESH_MODEL_UART_BRIDGE(uart_bridge)              \
		BT_MESH_MODEL_VND_CB(CONFIG_BT_COMPANY_ID,          \
                     BT_MESH_UART_BRIDGE_VENDOR_MODEL_ID,   \
                     _bt_mesh_uart_bridge_opcode_list,      \
                     &(uart_bridge)->pub,                   \
                     (void*)uart_bridge,                    \
                     &_bt_mesh_uart_bridge_cb)

struct bt_mesh_uart_bridge {
    /** Pointer to the UART Bridge Model instance */
    const struct bt_mesh_model *model;
    /** UART Bridge Model Publication context*/
    struct bt_mesh_model_pub pub;
    /** Simple network buffer for UART Bridge Model publication data */
    struct net_buf_simple pub_msg;
    uint8_t buf[BT_MESH_UART_BRIDGE_OP_CODE_SIZE                \
                + CONFIG_BT_MESH_UART_BRIDGE_PAYLOAD_LEN        \
                + BT_MESH_MIC_SHORT];
    /** UART Bridge Model callbacks */
    const struct bt_mesh_uart_bridge_cb *cb;
};

struct bt_mesh_uart_bridge_cb {
    /**
     * @brief Callback for handling received payload.
     *
     * @param uart_bridge Pointer to the bt_mesh_uart_bridge instance.
     * @param ctx         Message context for the incoming message.
     * @param payload     Payload of the incoming message.
    */
    int (*const payload)(const struct bt_mesh_uart_bridge *uart_bridge,
                         struct bt_mesh_msg_ctx *ctx,
                         const uint8_t *payload);
};

/**
 * @brief Publish a payload to the UART Bridge Model.
 *
 * @param model   Pointer to the UART Bridge Model instance.
 * @param payload Pointer to the payload data.
 *
 * @return 0 on success, or (negative) error code on failure.
 */
int bt_mesh_uart_bridge_payload_send(const struct bt_mesh_model *model,
                                     const uint8_t *payload);


/** @cond INTERNAL_HIDDEN */
extern const struct bt_mesh_model_op _bt_mesh_uart_bridge_opcode_list[];
extern const struct bt_mesh_model_cb _bt_mesh_uart_bridge_cb;

#ifdef __cplusplus
}
#endif

#endif /* UART_BRIDGE_MODEL_H */
```

## src/board.c
```c
/* board.c - Generic HW interaction hooks */

/*
 * Copyright (c) 2021 Nordic Semiconductor
 * Copyright (c) 2025 Texas Instruments Incorporated
 *
 * SPDX-License-Identifier: Apache-2.0
 */

#include <zephyr/bluetooth/mesh.h>
#include <zephyr/drivers/gpio.h>
#include "board.h"

/* Locate led0 as alias or label by that name */
#if DT_NODE_EXISTS(DT_ALIAS(led0))
#define LED0 DT_ALIAS(led0)
#elif DT_NODE_EXISTS(DT_NODELABEL(led0))
#define LED0 DT_NODELABEL(led0)
#else
#define LED0 DT_INVALID_NODE
#endif

#if DT_NODE_EXISTS(LED0)
#define LED0_DEV DT_PHANDLE(LED0, gpios)
#define LED0_PIN DT_PHA(LED0, gpios, pin)
#define LED0_FLAGS DT_PHA(LED0, gpios, flags)

static const struct device *const led_dev = DEVICE_DT_GET(LED0_DEV);
#endif /* LED0 */

static int led_init(void)
{
#if DT_NODE_EXISTS(LED0)
	int err;

	if (!device_is_ready(led_dev)) {
		return -ENODEV;
	}

	err = gpio_pin_configure(led_dev, LED0_PIN,
				 LED0_FLAGS | GPIO_OUTPUT_INACTIVE);
	if (err) {
		return err;
	}
#else
	printk("WARNING: LEDs not supported on this board.\n");
#endif

	return 0;
}

int board_init(void)
{
	int err;

	err = led_init();
	if (err) {
		return err;
	}

	return 0;
}

void board_led_set(bool val)
{
#if DT_NODE_EXISTS(LED0)
	gpio_pin_set(led_dev, LED0_PIN, val);
#endif
}

void board_output_number(bt_mesh_output_action_t action, uint32_t number)
{
}

void board_prov_complete(void)
{
}
```

## src/board.h
```c
/* board.h - Board-specific hooks */

/*
 * Copyright (c) 2017 Intel Corporation
 * Copyright (c) 2025 Texas Instruments Incorporated
 *
 * SPDX-License-Identifier: Apache-2.0
 */

void board_output_number(bt_mesh_output_action_t action, uint32_t number);

void board_prov_complete(void);

int board_init(void);

void board_led_set(bool val);
```

## src/uart_bridge_model.c
```c
/*
 * Copyright (c) 2025, Texas Instruments Incorporated
 *
 * SPDX-License-Identifier: Apache-2.0
 */
#include <zephyr/bluetooth/mesh.h>
#include "uart_bridge_model.h"

#define LOG_LEVEL CONFIG_BT_MESH_MODEL_LOG_LEVEL
#include <zephyr/logging/log.h>
LOG_MODULE_REGISTER(bt_mesh_uart_bridge);

BUILD_ASSERT(CONFIG_BT_MESH_UART_BRIDGE_PAYLOAD_LEN <=
            (BT_MESH_UART_BRIDGE_PAYLOAD_MAXLEN),
            "Payload size is too long");

/* Forward declarations */
static int payload(const struct bt_mesh_model *model,
                   struct bt_mesh_msg_ctx *ctx,
                   struct net_buf_simple *buf);
static int uart_bridge_init(const struct bt_mesh_model *model);

/* Model Operation Codes and callbacks */
const struct bt_mesh_model_op _bt_mesh_uart_bridge_opcode_list[] = {
    {
        BT_MESH_UART_BRIDGE_OP_PAYLOAD,
        BT_MESH_UART_BRIDGE_PAYLOAD_MINLEN,
        payload
    },
    BT_MESH_MODEL_OP_END,
};

/* Model Callbacks */
const struct bt_mesh_model_cb _bt_mesh_uart_bridge_cb = {
    .init = uart_bridge_init,
    .reset = NULL,
    .start = NULL,
};

/*
 * OpCodes Callbacks
 *
 * These callbacks are called when the corresponding OpCode is received.
*/
static int payload(const struct bt_mesh_model *model,
                   struct bt_mesh_msg_ctx *ctx,
                   struct net_buf_simple *buf)
{
    const struct bt_mesh_uart_bridge *uart_bridge = model->rt->user_data;

    if (buf->len < BT_MESH_UART_BRIDGE_PAYLOAD_MINLEN) {
        return -EINVAL;
    }

    if (buf->len > BT_MESH_UART_BRIDGE_PAYLOAD_MAXLEN) {
        return -EMSGSIZE;
    }

    uart_bridge->cb->payload(uart_bridge, ctx, buf->data);

    return 0;
}

/*
 * Define Model Callbacks
*/
static int uart_bridge_init(const struct bt_mesh_model *model)
{
    struct bt_mesh_uart_bridge *uart_bridge = model->rt->user_data;

    if (!uart_bridge) {
		LOG_ERR("No UART Bridge context provided");
		return -EINVAL;
	}

    if (!model->pub) {
		LOG_ERR("UART Bridge has no publication support");
		return -EINVAL;
	}

    uart_bridge->model = model;
    net_buf_simple_init_with_data(&(uart_bridge->pub_msg),
                                  uart_bridge->buf,
                                  sizeof(uart_bridge->buf));
    uart_bridge->pub.msg = &(uart_bridge->pub_msg);

    return 0;
}

int bt_mesh_uart_bridge_payload_send(const struct bt_mesh_model *model,
                                     const uint8_t *payload)
{
	/* Set the message's opcode */
	bt_mesh_model_msg_init(model->pub->msg, BT_MESH_UART_BRIDGE_OP_PAYLOAD);
	/* Add the payload to the message buffer */
	net_buf_simple_add_mem(model->pub->msg, payload, CONFIG_BT_MESH_UART_BRIDGE_PAYLOAD_LEN);

    model->pub->msg->data[CONFIG_BT_MESH_UART_BRIDGE_PAYLOAD_LEN - 1] = '\0';

	return bt_mesh_model_publish(model);
}
```
