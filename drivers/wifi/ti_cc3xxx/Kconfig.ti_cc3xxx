## drivers/wifi/ti_cc3xxx/Kconfig.ti_cc3xxx
```kconfig
# Texas Instruments CC3XXX Wi-Fi driver options

# Copyright (c) 2025-2026 Conclusive Engineering sp. z o. o.
# SPDX-License-Identifier: Apache-2.0

menuconfig WIFI_TI_CC3XXX
	bool "Texas Instruments CC3XXX Wi-Fi driver support"
	select WIFI_USE_NATIVE_NETWORKING
	select WIFI_OFFLOAD
	select NET_L2_WIFI_MGMT
	select DYNAMIC_THREAD
	select DYNAMIC_THREAD_ALLOC
	select THREAD_STACK_INFO
	select POSIX_API
	select SHARED_MULTI_HEAP
	select FLASH
	select FLASH_MAP
	select NVS
	select INIT_STACKS

if WIFI_TI_CC3XXX

config WIFI_TI_CC3XXX_MTU
	int "Maximum size of a packet, in bytes"
	# MTU (ipv4) per: http://www.ti.com/lit/ug/swru455d/swru455d.pdf:
	default 1472
	help
	  Set the maximum size of a network packet going through the chip.
	  This sets the size of each buffer, in each buffer pool.
	  Do not modify it unless you know what you are doing.

config WIFI_TI_CC3XXX_TX_CTRL_BLK_NUM
	int "Number of TX control block entries"
	default 120
	range 32 120
	help
	  Number of TX packet descriptors the WiFi stack can queue
	  simultaneously. Each entry uses ~344 bytes of heap.
	  Increase for high-throughput workloads.

config WIFI_TI_CC3XXX_NVS_INIT_PRIORITY
	int "NVS init priority"
	default 60
	help
	  SYS_INIT priority for the WiFi NVS init.
	  Must be lower than the WiFi driver init priority (80).

config WIFI_TI_CC35XX_NVS_INIT_PRIORITY
	int
	default WIFI_TI_CC3XXX_NVS_INIT_PRIORITY

config WIFI_TI_CC33XX
	bool
	default y if DT_HAS_TI_CC33XX_SPI_ENABLED

config WIFI_TI_CC35XX
	bool
	default y if DT_HAS_TI_CC35XX_WLAN_ENABLED

endif # WIFI_TI_CC3XXX
```

## dts/bindings/bluetooth/ti,cc33xx-uart.yaml
```yaml
# Copyright (c) 2026 Conclusive Engineering Sp. z o.o.
# SPDX-License-Identifier: Apache-2.0

include: "ti,cc3xxx-bt-hci.yaml"

description: Bluetooth HCI for Texas Instruments CC33xx NP

compatible: "ti,cc33xx-uart"

properties:
  bt-hci-name:
    default: "TI CC33XX BT HCI"
  bt-hci-bus:
    default: "BT_HCI_BUS_UART"
```

## dts/bindings/bluetooth/ti,cc3xxx-bt-hci.yaml
```yaml
# Copyright (c) 2025-2026 Conclusive Engineering sp. z o. o.
# SPDX-License-Identifier: Apache-2.0

include: bt-hci.yaml

description: Bluetooth HCI for Texas Instruments CC3xxx NP

compatible: "ti,cc3xxx-bt-hci"
```

## dts/bindings/dma/ti,cc35xx-dma.yaml
```yaml
# Copyright (c) 2025 Conclusive Engineering Sp. z o.o.
#
# SPDX-License-Identifier: Apache-2.0

description: |
  TI Simplelink DMA controller for the cc35xx chip family.

compatible: "ti,cc35xx-dma"

include: dma-controller.yaml

properties:
  "#dma-cells":
    const: 1

dma-cells:
  - channel
```

## dts/bindings/gpio/ti,cc35xx-gpio-port-bank.yaml
```yaml
# SPDX-License-Identifier: Apache-2.0

description: TI GPIO ports bank node

compatible: "ti,cc35xx-gpio-port-bank"

include: [base.yaml]

properties:
  ngpios:
    type: int
    default: 40
    description: |
      Number of GPIOs available on port bank.
```

## dts/bindings/misc/ti,cc140xp-trx.yaml
```yaml
# Copyright (c) 2026 Texas Instruments Incorporated
# SPDX-License-Identifier: Apache-2.0

description: TI CC140xP Transceiver

compatible: "ti,cc140xp-trx"

include: [spi-device.yaml]

properties:
  reset-gpios:
    type: phandle-array
    required: true
    description: |
      GPIO connected to the TRX_RESET pin.
      This pin is used to reset the transceiver.

  trx-host-spi-int-gpios:
    type: phandle-array
    required: true
    description: |
      GPIO connected to the TRX_HOST_SPI_INT pin.
      This pin is used for interrupt signaling from the transceiver.

  poci-gpios:
    type: phandle-array
    required: true
    description: |
      GPIO connected to the SPI POCI (MISO) pin.
      Polled after CS assertion to detect when the TRX is ready to receive
      (TRX drives POCI low as a ready handshake).
```

## dts/bindings/serial/ti,cc35xx-uart.yaml
```yaml
description: TI CC35XX UART

compatible: "ti,cc35xx-uart"

include: [uart-controller.yaml, pinctrl-device.yaml]

properties:
  reg:
    required: true

  pinctrl-0:
    required: true

  pinctrl-names:
    required: true
```

## dts/bindings/wifi/ti,cc33xx-spi.yaml
```yaml
# Copyright (c) 2026 Conclusive Engineering Sp. z o.o.
# SPDX-License-Identifier: Apache-2.0

include: [base.yaml, spi-device.yaml, "ti,cc3xxx-wlan.yaml"]

description: Texas Instruments CC33XX Wi-Fi controller

compatible: "ti,cc33xx-spi"

properties:
  wifi-reg-on-gpios:
    description: |
      Power-up/down gpio to control the internal regulators used
      by the WiFi section of CC33XX Wi-Fi device.
    type: phandle-array

  wifi-host-wake-gpios:
    description: |
      Host wake-up gpio. Signal from the CC33XX Wi-Fi device
      to the host indicating that the device requires attention.
    type: phandle-array
```

## dts/bindings/wifi/ti,cc35xx-wlan.yaml
```yaml
# Copyright (c) 2025-2026 Conclusive Engineering Sp. z o. o.
# SPDX-License-Identifier: Apache-2.0

include: [base.yaml, "ti,cc3xxx-wlan.yaml"]

description: Texas Instruments CC35XX Wi-Fi controller

compatible: "ti,cc35xx-wlan"
```

## dts/bindings/wifi/ti,cc3xxx-wlan.yaml
```yaml
# Copyright (c) 2026 Conclusive Engineering sp. z o.o.
# SPDX-License-Identifier: Apache-2.0

description: Texas Instruments CC3XXX Wi-Fi controller

compatible: "ti,cc3xxx-wlan"
```

## samples/bluetooth/broadcaster/sample.yaml
```yaml
sample:
  name: broadcaster
tests:
  sample.bluetooth.broadcaster:
    harness: bluetooth
    platform_allow:
      - qemu_cortex_m3
      - qemu_x86
      - nrf51dk/nrf51822
      - nrf52dk/nrf52832
      - lp_em_cc2340r5
    tags: bluetooth
    integration_platforms:
      - qemu_cortex_m3
```

## samples/bluetooth/esl/ap_cli/Kconfig
```kconfig
# EtherMind ESL AP Options
#
# Use this Kconfig for AP builds only.
# Set options in prj.conf, e.g.:
#   CONFIG_BT_ESL_AP=y
#

source "Kconfig"

menu "EtherMind ESL AP Options"

config BT_ESL_AP
	bool "Enable ESL Access Point Role"
	default n

config BT_ESL_SEPARATE_KEY_PER_GROUP
	bool "Enable Separate Key Per Group (AP only)"
	depends on BT_ESL_AP
	default n

config BT_ESL_VENDOR_SPECIFIC_COMMANDS
	bool "Enable ESL Vendor Specific Commands"
	default n

config BT_ESL_DYNAMIC_GLOBAL_CONFIGURATION
	bool "Enable ESL Dynaic Configuration of Global Limits"
	default y

config ESL_PL_DEBUG_TO_CONSOLE
	bool "Enable diverting ESL-PL Debug Logs to Console as Printk"
	default n

# ESL Common Limits
config BT_ESL_MAX_SENSOR_SUPPORTED
	int "Maximum # of Sensor to be supported"
	range 1 256
	default 256

config BT_ESL_MAX_LED_SUPPORTED
	int "Maximum # of LED to be supported"
	range 1 256
	default 256

config BT_ESL_MAX_IMAGE_SUPPORTED
	int "Maximum # of Image to be supported"
	range 1 256
	default 256

config BT_ESL_MAX_DISPLAY_SUPPORTED
	int "Maximum # of Display to be supported"
	range 1 102
	default 102

config BT_ESL_MAX_NO_OF_RESPONSE
	int "Maximum # of Responses to be supported"
	range 1 24
	default 24

config BT_ESL_MAX_GROUPS_SUPPORTED
	int "Maximum # of Groups to be supported"
	range 1 128
	default 128

config BT_ESL_MAX_ESL_TAGS_SUPPORTED
	int "Maximum # of Tags to be supported"
	range 1 255
	default 255

# ESL AP Limits
config BT_ESL_SYNC_RETRY_COUNT
	int "Maximum # of Sync Retry"
	range 1 10
	default 5
	depends on BT_ESL_AP

config BT_ESL_AP_SYNC_RETRY_INTERVAL_MS
	int "Sync Retry Interval (in ms)"
	range 100 10000
	default 2000
	depends on BT_ESL_AP

config BT_ESL_AP_CONFIG_TIMEOUT
	int "Configuration Timeout (in seconds)"
	range 10 100
	default 60
	depends on BT_ESL_AP
endmenu
```

## samples/bluetooth/esl/ap_cli/sample.yaml
```yaml
sample:
  name: esl_ap_cli
  description: ESL Access Point with CLI
tests:
  sample.bluetooth.esl.ap_cli:
    harness: bluetooth
    build_only: true
    platform_allow:
      - lp_em_cc2745r10_q1/cc2745r10_q1
      - lp_em_cc2745r10_q1/cc2755r10
      - lp_em_cc2755p10
    integration_platforms:
      - lp_em_cc2745r10_q1/cc2745r10_q1
    tags: bluetooth
```

## samples/bluetooth/esl/tag_cli/Kconfig
```kconfig
# EtherMind ESL Tag Options
#
# Use this Kconfig for TAG builds only.
# Set options in prj.conf, e.g.:
#   CONFIG_BT_ESL_TAG=y
#

source "Kconfig"

menu "EtherMind ESL Tag Options"

config BT_ESL_TAG
	bool "Enable ESL Tag Role"
	default y

config BT_ESL_LED
	bool "Enable ESL LED Support"
	depends on BT_ESL_TAG
	default y

config BT_ESL_SENSOR
	bool "Enable ESL Sensor Support"
	depends on BT_ESL_TAG
	default y

config BT_ESL_DISPLAY
	bool "Enable ESL Display Support"
	depends on BT_ESL_TAG
	default y

config BT_ESL_WAIT_TIMEOUT
	bool "Enable ESL Wait Timeout Feature for ESL State Monitoring"
	depends on BT_ESL_TAG
	default y

config BT_ESL_VENDOR_SPECIFIC_COMMANDS
	bool "Enable ESL Vendor Specific Commands"
	default n

config BT_ESL_DYNAMIC_GLOBAL_CONFIGURATION
	bool "Enable ESL Dynaic Configuration of Global Limits"
	default n

config ESL_PL_DEBUG_TO_CONSOLE
	bool "Enable diverting ESL-PL Debug Logs to Console as Printk"
	default n

# ESL Common Limits
config BT_ESL_MAX_SENSOR_SUPPORTED
	int "Maximum # of Sensor to be supported"
	range 1 256
	default 256

config BT_ESL_MAX_LED_SUPPORTED
	int "Maximum # of LED to be supported"
	range 1 256
	default 256

config BT_ESL_MAX_IMAGE_SUPPORTED
	int "Maximum # of Image to be supported"
	range 1 256
	default 256

config BT_ESL_MAX_DISPLAY_SUPPORTED
	int "Maximum # of Display to be supported"
	range 1 102
	default 102

config BT_ESL_MAX_NO_OF_RESPONSE
	int "Maximum # of Responses to be supported"
	range 1 24
	default 24

config BT_ESL_MAX_GROUPS_SUPPORTED
	int "Maximum # of Groups to be supported"
	range 1 128
	default 128

config BT_ESL_MAX_ESL_TAGS_SUPPORTED
	int "Maximum # of Tags to be supported"
	range 1 255
	default 255

# include OTS kconfig
rsource "Kconfig.ots"

endmenu
```

## samples/bluetooth/esl/tag_cli/Kconfig.ots
```kconfig
# Ethermind ESL OTS Configuration
#
# Use this configuration for tag builds only.
# Set options in prj.conf, e.g.:
#   CONFIG_BT_ESL_OTS=y
#

config BT_ESL_OTS
    bool "Enable ESL OTS features"
    select BT_OTS
    select BT_OTS_OBJ_NAME_WRITE_SUPPORT
    select BT_OTS_OACP_WRITE_SUPPORT
    select BT_OTS_OACP_PATCH_SUPPORT
    select BT_OTS_OACP_CREATE_SUPPORT
    select BT_OTS_OACP_DELETE_SUPPORT
    select BT_OTS_OACP_CHECKSUM_SUPPORT
    select BT_L2CAP_DYNAMIC_CHANNEL
    default n
    help
      Enable all required OTS features for ESL.

if BT_ESL_OTS

config BT_OTS_SECONDARY_SVC
    default n

# RX ACL Buffer Size: must be large enough for MPS + L2CAP header
config BT_BUF_ACL_RX_SIZE
    default 69

# Default L2CAP MTU
config BT_L2CAP_TX_MTU
    default 69

endif # BT_ESL_OTS
```

## samples/bluetooth/esl/tag_cli/sample.yaml
```yaml
sample:
  name: esl_tag_cli
  description: ESL Tag with CLI
tests:
  sample.bluetooth.esl.tag_cli:
    harness: bluetooth
    build_only: true
    platform_allow:
      - lp_em_cc2340r53
      - lp_em_cc2340r53_wcsp
      - lp_em_cc2340r5moda
      - lp_em_cc2745r10_q1/cc2745r10_q1
      - lp_em_cc2745r10_q1/cc2755r10
      - lp_em_cc2755p10
      - lp_em_cc2755p20
    integration_platforms:
      - lp_em_cc2340r53
    tags: bluetooth
```

## samples/bluetooth/mesh/boards/teensy41.conf
```kconfig
CONFIG_BT_HCI_TI_CC3XXX=y

CONFIG_REBOOT=y
CONFIG_HWINFO=y
CONFIG_SYSTEM_WORKQUEUE_STACK_SIZE=8192

CONFIG_NETWORKING=y
CONFIG_NET_L2_ETHERNET=y

CONFIG_MBEDTLS=n

CONFIG_HEAP_MEM_POOL_SIZE=153600
CONFIG_MAIN_STACK_SIZE=61440

CONFIG_NET_TX_STACK_SIZE=2048
CONFIG_NET_RX_STACK_SIZE=2048
CONFIG_DYNAMIC_THREAD_PREFER_POOL=y
CONFIG_DYNAMIC_THREAD_POOL_SIZE=4
CONFIG_DYNAMIC_THREAD_STACK_SIZE=8192

CONFIG_BT_DEVICE_NAME="TI Zephyr Mesh"
CONFIG_BT_MESH_ADV_BUF_COUNT=16
CONFIG_BT_BUF_ACL_RX_SIZE=255
CONFIG_BT_BUF_ACL_RX_COUNT=12
CONFIG_BT_BUF_EVT_RX_SIZE=255
CONFIG_BT_HCI_ACL_FLOW_CONTROL=n
CONFIG_BT_PHY_UPDATE=n
CONFIG_BT_AUTO_PHY_UPDATE=n

CONFIG_LOG=y
CONFIG_LOG_BUFFER_SIZE=8192
CONFIG_BT_LOG_LEVEL_INF=y
CONFIG_BT_MESH_LOG_LEVEL_INF=y
```

## samples/bluetooth/observer/sample.yaml
```yaml
sample:
  name: observer
tests:
  sample.bluetooth.observer:
    harness: bluetooth
    platform_allow:
      - qemu_cortex_m3
      - qemu_x86
      - lp_em_cc2340r5
      - lp_em_cc2340r53
      - lp_em_cc2745r10_q1/cc2745r10_q1
      - lp_em_cc2745r10_q1/cc2755r10
      - nrf52840dk/nrf52840
    integration_platforms:
      - qemu_cortex_m3
    tags: bluetooth
  sample.bluetooth.observer.extended:
    harness: bluetooth
    extra_args: CONF_FILE="prj_extended.conf"
    platform_allow:
      - qemu_cortex_m3
      - qemu_x86
      - nrf52840dk/nrf52840
    tags: bluetooth
    integration_platforms:
      - qemu_cortex_m3
```

## samples/bluetooth/peripheral/boards/lp_em_cc35x1.conf
```kconfig
CONFIG_BT_HCI_TI_CC3XXX=y

CONFIG_NET_L2_ETHERNET=y
CONFIG_NETWORKING=y

CONFIG_BT_PHY_UPDATE=n
CONFIG_BT_AUTO_PHY_UPDATE=n

# Below memory constraints are enforced by the Wi-Fi stack
CONFIG_HEAP_MEM_POOL_SIZE=81920
CONFIG_MAIN_STACK_SIZE=61440
CONFIG_NET_TX_STACK_SIZE=2048
CONFIG_NET_RX_STACK_SIZE=2048
CONFIG_DYNAMIC_THREAD_PREFER_POOL=y
CONFIG_DYNAMIC_THREAD_POOL_SIZE=3
CONFIG_DYNAMIC_THREAD_STACK_SIZE=8192
CONFIG_NET_PKT_RX_COUNT=10
CONFIG_NET_PKT_TX_COUNT=10
CONFIG_NET_BUF_RX_COUNT=20
CONFIG_NET_BUF_TX_COUNT=20
CONFIG_NET_MAX_CONTEXTS=10
```

## samples/bluetooth/peripheral/boards/teensy41.conf
```kconfig
CONFIG_BT_HCI_TI_CC3XXX=y

CONFIG_MBEDTLS=n

CONFIG_BT_HCI_ACL_FLOW_CONTROL=n
CONFIG_BT_PHY_UPDATE=n
CONFIG_BT_AUTO_PHY_UPDATE=n

CONFIG_NETWORKING=y
CONFIG_NET_L2_ETHERNET=y

# Below memory constraints are enforced by the Wi-Fi stack
CONFIG_HEAP_MEM_POOL_SIZE=122880
CONFIG_MAIN_STACK_SIZE=61440
CONFIG_NET_TX_STACK_SIZE=2048
CONFIG_NET_RX_STACK_SIZE=2048
CONFIG_DYNAMIC_THREAD_PREFER_POOL=y
CONFIG_DYNAMIC_THREAD_POOL_SIZE=4
CONFIG_DYNAMIC_THREAD_STACK_SIZE=8192
CONFIG_NET_PKT_RX_COUNT=10
CONFIG_NET_PKT_TX_COUNT=10
CONFIG_NET_BUF_RX_COUNT=20
CONFIG_NET_BUF_TX_COUNT=20
CONFIG_NET_MAX_CONTEXTS=10
```

## samples/bluetooth/peripheral/sample.yaml
```yaml
sample:
  name: Bluetooth Peripheral
  description: Demonstrates the BLE Peripheral role
tests:
  sample.bluetooth.peripheral:
    harness: bluetooth
    platform_allow:
      - qemu_x86
      - lp_em_cc2340r5
      - lp_em_cc2340r5moda
      - lp_em_cc2340r53
      - lp_em_cc2340r53_wcsp
      - lp_em_cc2745r10_q1/cc2745r10_q1
      - lp_em_cc2745r10_q1/cc2755r10
      - lp_em_cc2755p10
      - lp_em_cc2755p20
      - nucleo_wb55rg
    integration_platforms:
      - qemu_x86
    tags: bluetooth
  sample.bluetooth.peripheral.ti_lpf3.coex_3wire_cc23xx:
    harness: bluetooth
    platform_allow:
      - lp_em_cc2340r5
      - lp_em_cc2340r5moda
      - lp_em_cc2340r53
      - lp_em_cc2340r53_wcsp
    extra_args: EXTRA_DTC_OVERLAY_FILE=boards/cc23xx_coex_3wire.overlay
    extra_configs:
      - CONFIG_RCL_COEX=y
    tags: bluetooth
  sample.bluetooth.peripheral.ti_lpf3.coex_3wire_cc27xx:
    harness: bluetooth
    platform_allow:
      - lp_em_cc2745r10_q1/cc2745r10_q1
      - lp_em_cc2745r10_q1/cc2755r10
      - lp_em_cc2755p10
      - lp_em_cc2755p20
    extra_args: EXTRA_DTC_OVERLAY_FILE=boards/cc27xx_coex_3wire.overlay
    extra_configs:
      - CONFIG_RCL_COEX=y
    tags: bluetooth
  sample.bluetooth.peripheral.x_nucleo_idb05a1_shield:
    harness: bluetooth
    platform_allow: nucleo_l4r5zi
    depends_on:
      - arduino_spi
      - arduino_gpio
    extra_args: SHIELD=x_nucleo_idb05a1
    integration_platforms:
      - nucleo_l4r5zi
```

## samples/boards/ti/cc23x0/pm/lgpt/sample.yaml
```yaml
sample:
  name: CC23x0 LGPT counter Driver Sample
common:
  tags:
    - drivers
    - counter
  harness: console
  harness_config:
    type: multi_line
    ordered: true
    regex:
      - "Counter alarm sample"
      - "Set alarm in 2 sec"
      - "!!! Alarm !!!"
      - "Now: [2|3]"
  depends_on: counter
tests:
  sample.drivers.counter.alarm:
    platform_allow:
      - lp_em_cc2340r5
    integration_platforms:
      - lp_em_cc2340r5
```
