## boards/shields/ti_bp_cc140xp/Kconfig.shield
```kconfig
# Copyright (c) 2026 Texas Instruments Incorporated
# SPDX-License-Identifier: Apache-2.0

config SHIELD_TI_BP_CC140XP
	def_bool $(shields_list_contains,ti_bp_cc140xp)
```

## boards/ti/lp_em_cc2340r5/Kconfig.defconfig
```kconfig
# Copyright (c) 2024 Texas Instruments Incorporated
#
# SPDX-License-Identifier: Apache-2.0

rsource "../lpf3_common/Kconfig.defconfig"

if BOARD_LP_EM_CC2340R5

if BT

config ZEPHYR
  bool
  default y

config BT_LL_HEAP_SIZE
    hex
    default 0x1880

config BT_BUF_EVT_RX_SIZE
  default 255

config BT_BUF_ACL_RX_SIZE
  default 255

config BT_BUF_ACL_TX_SIZE
  default 255

config BT_BUF_CMD_TX_SIZE
  default 255

config BT_COMPANY_ID
  default 0x000D

endif # BT

if PM
# Power Management requires increased idle task stack size because of
# stack usage introduced by "pm_state_set"
config IDLE_STACK_SIZE
  default 320
endif # PM

endif # BOARD_LP_EM_CC2340R5
```

## boards/ti/lp_em_cc2340r53/Kconfig.defconfig
```kconfig
# Copyright (c) 2024 Texas Instruments Incorporated
#
# SPDX-License-Identifier: Apache-2.0

rsource "../lpf3_common/Kconfig.defconfig"

if BOARD_LP_EM_CC2340R53

if BT

config ZEPHYR
	bool
	default y

config BT_LL_HEAP_SIZE
	hex
	default 0x1880 if BT_MESH
	default 0x4000

config BT_BUF_EVT_RX_SIZE
	default 255

config BT_BUF_ACL_RX_SIZE
	default 255

config BT_BUF_ACL_TX_SIZE
	default 251

config BT_BUF_CMD_TX_SIZE
	default 255

config BT_COMPANY_ID
	default 0x000D

choice BT_RECV_CONTEXT
	bool
	default BT_RECV_WORKQ_BT if BT_MESH
	default BT_RECV_WORKQ_SYS
endchoice

endif # BT

if PM
# Power Management requires increased idle task stack size because of
# stack usage introduced by "pm_state_set"
config IDLE_STACK_SIZE
	default 320
endif # PM

endif # BOARD_LP_EM_CC2340R53
```

## boards/ti/lp_em_cc2340r5moda/Kconfig.lp_em_cc2340r5moda
```kconfig
# Copyright (c) 2026 Texas Instruments Incorporated
#
# SPDX-License-Identifier: Apache-2.0

config BOARD_LP_EM_CC2340R5MODA
	select SOC_CC2340R5

config BOARD_USE_LF_XOSC
	bool "Use external low-frequency crystal"
	default y
```

## boards/ti/lp_em_cc2745r10_q1/board.yml
```yaml
board:
  name: lp_em_cc2745r10_q1
  vendor: ti
  socs:
    - name: cc2745r10_q1
    - name: cc2755r10
```

## boards/ti/lp_em_cc2755p10/Kconfig.defconfig
```kconfig
# Copyright (c) 2026 Texas Instruments Incorporated
#
# SPDX-License-Identifier: Apache-2.0

rsource "../lpf3_common/Kconfig.defconfig"

if BOARD_LP_EM_CC2755P10

if BT

config ZEPHYR
	bool
	default y

config BT_LL_HEAP_SIZE
	hex
	default 0x4E00

config BT_BUF_EVT_RX_SIZE
	default 255

config BT_BUF_ACL_RX_SIZE
	default 255

config BT_BUF_ACL_TX_SIZE
	default 251

config BT_BUF_CMD_TX_SIZE
	default 255

config BT_COMPANY_ID
	default 0x000D

choice BT_RECV_CONTEXT
	bool
	default BT_RECV_WORKQ_BT if BT_MESH
	default BT_RECV_WORKQ_SYS
endchoice

endif # BT

# The SPI driver only supports DMA mode
if SPI
config SPI_CC23X0_CC27XX_DMA_DRIVEN
	default y
endif # SPI

endif # BOARD_LP_EM_CC2755P10
```

## boards/ti/lp_em_cc35x1/Kconfig.lp_em_cc35x1
```kconfig
# TI CC35X1 LaunchPad board
# Copyright (c) 2025 Conclusive Engineering Sp. z o.o.
# SPDX-License-Identifier: Apache-2.0

config BOARD_LP_EM_CC35X1
	bool
	select SOC_CC3551E
```

## boards/ti/lpf3_common/Kconfig.defconfig
```kconfig
# Copyright (c) 2024 Texas Instruments Incorporated
#
# SPDX-License-Identifier: Apache-2.0

if TI_MCUMGR_BT_OTA_DFU
	config MCUMGR_TRANSPORT_NETBUF_SIZE
		default 550
	config BT_L2CAP_TX_MTU
		default 65
endif # TI_MCUMGR_BT_OTA_DFU

if BT_MESH
	config BT_HOST_CRYPTO_PRNG
		default n

	config BT_CTLR_CRYPTO
		default y

	config BT_HOST_CRYPTO
		default y

if BT_MESH_FRIEND
	config BT_MESH_FRIEND_ADV_LATENCY
		default 10
endif # BT_MESH_FRIEND

if BT_MESH_LOW_POWER
	config BT_MESH_LPN_SCAN_LATENCY
		default 6

	config BT_MESH_GATT_PROXY
		default n

	config BT_MESH_PRIV_BEACONS
		default n

	config BT_MESH_BEACON_ENABLED
		default n

	config BT_MESH_RELAY
		default n

	config BT_MESH_FRIEND
		default n

endif # BT_MESH_LOW_POWER
endif # BT_MESH
```

## drivers/dma/Kconfig.ti_cc35xx
```kconfig
# SPDX-License-Identifier: Apache-2.0

config DMA_TI_CC35XX
	bool "CC35XX MCU DMA driver"
	default y
	depends on DT_HAS_TI_CC35XX_DMA_ENABLED
	help
	  Enable DMA support on the CC35XX family of processors.
```

## drivers/entropy/Kconfig.cc35xx
```kconfig
# TI CC35xxE entropy driver configuration

# Copyright (c) 2025 Conclusive Engineering Sp. z o.o.
# SPDX-License-Identifier: Apache-2.0

config ENTROPY_CC35XX_RNG
	bool "TI SimpleLink CC35xxE Hardware Security Module (HSM)"
	default y
	depends on DT_HAS_TI_CC35XX_HSM_ENABLED
	select ENTROPY_HAS_DRIVER
	select RING_BUFFER
	help
	  This option enables the driver for the Hardware Security Module (HSM)
	  for TI SimpleLink CC35xxE SoCs.

if ENTROPY_CC35XX_RNG

config ENTROPY_CC35XX_POOL_SIZE
	int "Number of bytes in the entropy pool"
	default 512
	range 256 65536
	help
	  The size in bytes of the buffer used to store entropy generated by the
	  hardware. Should be a power of two for high performance.

endif # ENTROPY_CC35XX_RNG
```

## drivers/misc/ti_cc140xp/Kconfig
```kconfig
# TI CC140xP driver configuration
# Copyright (c) 2026 Texas Instruments Incorporated
# SPDX-License-Identifier: Apache-2.0

config TI_CC140XP
	bool "TI CC140xP Transceiver"
	default y
	depends on DT_HAS_TI_CC140XP_TRX_ENABLED
	depends on SPI
	depends on GPIO
	select SPI_ASYNC
	select CRC
	select RING_BUFFER
	help
	  This option enables the driver for the TI CC140xP Transceiver.
	  The device is connected via 3-wire SPI with manual CS control
	  and an additional interrupt pin.

if TI_CC140XP

config TI_CC140XP_INIT_PRIORITY
	int "TI CC140xP driver initialization priority"
	default 80
	help
	  Driver initialization priority for the TI CC140xP transceiver.
	  Must be initialized after SPI and GPIO subsystems.

module = TI_CC140XP
module-str = ti_cc140xp
source "subsys/logging/Kconfig.template.log_config"

endif # TI_CC140XP
```

## drivers/misc/ti_cc35xx_hsm/Kconfig
```kconfig
# TI CC35xxE HSM driver configuration
# Copyright (c) 2025 Conclusive Engineering Sp. z o.o.
# SPDX-License-Identifier: Apache-2.0

config TI_CC35XX_HSM
	bool "TI SimpleLink CC35xx Hardware Security Module (HSM)"
	default n
	depends on DT_HAS_TI_CC35XX_HSM_ENABLED
	select RING_BUFFER
	help
	  This option enables the driver for the Hardware Security Module (HSM)
	  for TI SimpleLink CC35xx family SoCs.

if TI_CC35XX_HSM

config TI_CC35XX_HSM_INIT_PRIORITY
	int "TI CC35XX HSM driver init priority"
	depends on TI_CC35XX_HSM
	default KERNEL_INIT_PRIORITY_DEVICE
	help
	  TI CC35XX HSM driver device initialization priority.


config TI_CC35XX_HSM_ENTROPY_POOL_SIZE
	int "Number of bytes in the entropy pool"
	default 512
	range 256 65536
	help
	  The size in bytes of the buffer used to store entropy generated by the
	  hardware. Should be a power of two for high performance.

endif # TI_CC35XX_HSM
```

## drivers/pwm/Kconfig.cc27xx_timer
```kconfig
# Copyright (c) 2025 Texas Instruments Incorporated
# SPDX-License-Identifier: Apache-2.0

config PWM_CC27XX_TIMER
	bool "TI SimpleLink CC27XX LGPT PWM driver"
	default y
	depends on DT_HAS_TI_CC27XX_LGPT_PWM_ENABLED
	select PINCTRL
	help
	  Enables TI SimpleLink CC27XX LGPT PWM driver.
```

## drivers/pwm/Kconfig.cc35xx_timer
```kconfig
# SPDX-License-Identifier: Apache-2.0

config PWM_CC35XX_TIMER
	bool "TI SimpleLink CC35XX LGPT PWM driver"
	default y
	depends on DT_HAS_TI_CC35XX_LGPT_PWM_ENABLED
	select PINCTRL
	help
	  Enables TI SimpleLink CC35XX LGPT PWM driver.
```

## drivers/spi/Kconfig.cc35xx
```kconfig
# Copyright (c) 2025-2026 Conclusive Engineering
# SPDX-License-Identifier: Apache-2.0

config SPI_CC35XX
	bool "TI SimpleLink CC35xx SPI driver"
	default y
	depends on DT_HAS_TI_CC35XX_SPI_ENABLED
	select PINCTRL
	help
	  Enable support for the TI SimpleLink CC35xx SPI peripheral

if SPI_CC35XX

config SPI_CC35XX_DMA_DRIVEN
	bool "CC35XX SPI DMA support"
	default n
	select DMA
	help
	  Enables DMA for SPI transfers.

endif # SPI_CC35XX
```

## drivers/timer/Kconfig.lpf3
```kconfig
# Copyright (c) 2026 Texas Instruments Incorporated
# Copyright (c) 2024 BayLibre, SAS
#
# SPDX-License-Identifier: Apache-2.0

config LPF3_CLOCKP_TIMER
	bool "SYSTIM timer"
	default y
	depends on HAS_CC27XX_SDK || HAS_CC23X0_SDK
	select TICKLESS_CAPABLE
	select TIMER_HAS_64BIT_CYCLE_COUNTER if HAS_CC27XX_SDK
	help
	  This module provides ClockP DPL as "system clock driver" interfaces
	  for the TI Simplelink CC23X0 and CC27XX devices.
```

## drivers/wifi/ti_cc35xx/Kconfig.ti_cc35xx
```kconfig
# Texas Instruments CC35XX Wi-Fi driver options

# Copyright (c) 2025 Conclusive Engineering sp. z o. o.
# SPDX-License-Identifier: Apache-2.0

menuconfig WIFI_TI_CC35XX
	bool "Texas Instruments CC35XX Wi-Fi driver support"
	select WIFI_USE_NATIVE_NETWORKING
	select WIFI_OFFLOAD
	select NET_L2_WIFI_MGMT
	select DYNAMIC_THREAD
	select DYNAMIC_THREAD_ALLOC
	select THREAD_STACK_INFO
	select POSIX_API
	select FLASH
	select FLASH_MAP
	select NVS

if WIFI_TI_CC35XX

config WIFI_TI_CC35XX_MTU
	int "Maximum size of a packet, in bytes"
	# MTU (ipv4) per: http://www.ti.com/lit/ug/swru455d/swru455d.pdf:
	default 1472
	help
	  Set the maximum size of a network packet going through the chip.
	  This sets the size of each buffer, in each buffer pool.
	  Do not modify it unless you know what you are doing.

config WIFI_TI_CC35XX_TX_CTRL_BLK_NUM
	int "Number of TX control block entries"
	default 120
	range 32 120
	help
	  Number of TX packet descriptors the WiFi stack can queue
	  simultaneously. Each entry uses ~344 bytes of heap.
	  Increase for high-throughput workloads.

config WIFI_TI_CC35XX_NVS_INIT_PRIORITY
	int "NVS init priority"
	default 60
	help
	  SYS_INIT priority for the WiFi NVS init.
	  Must be lower than the WiFi driver init priority (80).

endif # WIFI_TI_CC35XX
```
