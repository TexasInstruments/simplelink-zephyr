/*
 * Copyright (c) 2026 Texas Instruments Incorporated
 *
 * SPDX-License-Identifier: Apache-2.0
 */

/ {
	resources {
		compatible = "test-gpio-basic-api";
		/* Use DIO11 and DIO22 for GPIO loopback testing */
		out-gpios = <&gpio0 11 0>;  /* DIO11 */
		in-gpios = <&gpio0 22 0>;  /* DIO22 */
	};
};
