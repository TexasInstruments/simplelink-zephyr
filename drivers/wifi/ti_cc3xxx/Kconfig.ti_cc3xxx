## samples/net/wifi/boards/teensy41.conf
```kconfig
CONFIG_WIFI=y
CONFIG_WIFI_TI_CC3XXX=y

CONFIG_SPI=y
CONFIG_GPIO=y

CONFIG_MBEDTLS=n

CONFIG_NETWORKING=y
CONFIG_NET_IPV4=y
CONFIG_NET_MGMT=y

CONFIG_NET_IPV6=n

CONFIG_NET_PKT_RX_COUNT=16
CONFIG_NET_PKT_TX_COUNT=16
CONFIG_NET_BUF_RX_COUNT=32
CONFIG_NET_BUF_TX_COUNT=32

CONFIG_NET_RX_STACK_SIZE=2048
CONFIG_NET_TX_STACK_SIZE=2048
CONFIG_NET_TCP_WORKQ_STACK_SIZE=2048
CONFIG_NET_MGMT_EVENT_QUEUE_SIZE=10

CONFIG_NET_L2_ETHERNET=y
CONFIG_WIFI_SHELL_MAX_AP_STA=4

CONFIG_NET_TCP_WORKQ_STACK_SIZE=4096
CONFIG_NET_MGMT_EVENT_STACK_SIZE=4096
CONFIG_IDLE_STACK_SIZE=2048

CONFIG_NET_MAX_CONTEXTS=10

CONFIG_HEAP_MEM_POOL_SIZE=102400
CONFIG_MAIN_STACK_SIZE=61440
CONFIG_SYSTEM_WORKQUEUE_STACK_SIZE=2048
CONFIG_NET_TX_STACK_SIZE=2048
CONFIG_NET_RX_STACK_SIZE=2048
CONFIG_DYNAMIC_THREAD_PREFER_POOL=y
CONFIG_DYNAMIC_THREAD_POOL_SIZE=3
CONFIG_DYNAMIC_THREAD_STACK_SIZE=8192

CONFIG_NET_IF_MAX_IPV4_COUNT=1
CONFIG_NET_MGMT_EVENT_QUEUE_SIZE=128
CONFIG_NET_MGMT_EVENT_QUEUE_TIMEOUT=500

CONFIG_MPU_ALLOW_FLASH_WRITE=y
```

## samples/shields/ti_bp_cc140xp/ti_cc140xp_carrier_wave/sample.yaml
```yaml
sample:
  name: TI CC140xP RF Carrier Wave Sample
  description: Sample application demonstrating TI CC140xP transceiver driver TX test mode functionality
common:
  tags:
    - drivers
    - prop_rf
    - shield
  depends_on: spi gpio
tests:
  sample.shields.ti_bp_cc140xp.ti_cc140xp_carrier_wave:
    harness: shield
    extra_args: SHIELD=ti_bp_cc140xp
    platform_allow:
      - lp_em_cc2745r10_q1/cc2745r10_q1
    integration_platforms:
      - lp_em_cc2745r10_q1/cc2745r10_q1
```

## samples/shields/ti_bp_cc140xp/ti_cc140xp_mdr_tx/sample.yaml
```yaml
sample:
  name: TI CC140xP Wi-SUN MDR TX Sample
  description: Sample application demonstrating TI CC140xP transceiver driver Wi-SUN Multi-Data-Rate (MDR) TX functionality
common:
  tags:
    - drivers
    - prop_rf
    - shield
  depends_on: spi gpio
tests:
  sample.shields.ti_bp_cc140xp.ti_cc140xp_mdr_tx:
    harness: shield
    extra_args: SHIELD=ti_bp_cc140xp
    platform_allow:
      - lp_em_cc2745r10_q1/cc2745r10_q1
    integration_platforms:
      - lp_em_cc2745r10_q1/cc2745r10_q1
```
