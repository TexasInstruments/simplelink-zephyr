## soc/ti/simplelink/cc35xxe/Kconfig.defconfig.cc3551e
```kconfig
# Copyright (c) 2025 Conclusive Engineering Sp. z o.o.
# Texas Instruments SimpleLink CC3551E SoC
# SPDX-License-Identifier: Apache-2.0

if SOC_CC3551E

config SYS_CLOCK_HW_CYCLES_PER_SEC
	int
	default 160000000

config SYS_CLOCK_TICKS_PER_SEC
	int
	default 1000

config NUM_IRQS
	int
	default 48

config XIP
	bool
	default n

config FLASH_LOAD_OFFSET
	hex
	default 0x101c if XIP
	default 0x0 if !XIP

config ROM_START_OFFSET
	hex
	default 0xe4 if XIP
	default 0x0 if !XIP

endif # SOC_CC3551E
```

## soc/ti/simplelink/cc35xxe/Kconfig.soc
```kconfig
# Copyright (c) 2025 Conclusive Engineering Sp. z o.o.
#
# SPDX-License-Identifier: Apache-2.0

config SOC_SERIES_CC35XXE
	bool
	select SOC_FAMILY_TI_SIMPLELINK
	help
	  Enable support for TI SimpleLink CC35xxE SoCs

config SOC_CC3551E
	bool
	select SOC_SERIES_CC35XXE

config SOC_SERIES
	string
	default "cc35xxe" if SOC_SERIES_CC35XXE

config SOC
	string
	default "cc3551e" if SOC_CC3551E
```

## tests/arch/arm/arm_interrupt/testcase.yaml
```yaml
common:
  filter: CONFIG_ARMV6_M_ARMV8_M_BASELINE or CONFIG_ARMV7_M_ARMV8_M_MAINLINE
  tags:
    - arm
    - fpu
    - interrupt
  ignore_faults: true
  arch_allow: arm
tests:
  arch.arm.interrupt:
    filter: not CONFIG_TRUSTED_EXECUTION_NONSECURE
  arch.arm.interrupt.no_optimizations:
    platform_exclude:
      - lp_em_cc2745r10_q1/cc2745r10_q1
      - lp_em_cc2745r10_q1/cc2755r10
      - lp_em_cc2755p10
      - lp_em_cc2340r5
      - lp_em_cc2340r53
    filter: not CONFIG_TRUSTED_EXECUTION_NONSECURE
    extra_configs:
      - CONFIG_NO_OPTIMIZATIONS=y
      - CONFIG_ZTEST_WARN_NO_OPTIMIZATIONS=n
      - CONFIG_IDLE_STACK_SIZE=512
      - CONFIG_MAIN_STACK_SIZE=2048
  arch.arm.interrupt.extra_exception_info:
    filter: not CONFIG_TRUSTED_EXECUTION_NONSECURE
    extra_configs:
      - CONFIG_EXTRA_EXCEPTION_INFO=y
```

## tests/bluetooth/tester/testcase.yaml
```yaml
tests:
  bluetooth.general.tester:
    build_only: true
    platform_allow:
      - qemu_x86
      - native_posix
      - native_sim
      - nrf52840dk/nrf52840
    tags: bluetooth
    harness: bluetooth
  bluetooth.general.tester.nxp:
    # Disabling monolithic since CI environment doesn't use blobs
    build_only: true
    harness: bluetooth
    platform_allow:
      - rd_rw612_bga
      - frdm_rw612
    extra_configs:
      - CONFIG_NXP_MONOLITHIC_BT=n
  bluetooth.general.tester_le_audio:
    build_only: true
    platform_allow:
      - qemu_x86
      - native_posix
      - native_sim
      - nrf5340dk/nrf5340/cpuapp
    extra_args: OVERLAY_CONFIG="overlay-le-audio.conf"
    tags: bluetooth
    harness: bluetooth
  bluetooth.general.tester_mesh:
    build_only: true
    platform_allow:
      - qemu_x86
      - native_posix
      - native_sim
      - nrf52840dk/nrf52840
    extra_args: OVERLAY_CONFIG="overlay-mesh.conf"
    tags: bluetooth
    harness: bluetooth
  bluetooth.general.tester.ti_lpf3:
    extra_args:
      - OVERLAY_CONFIG="boards/ti_lpf3.conf"
      - DTC_OVERLAY_FILE="boards/ti_lpf3.overlay"
    build_only: true
    platform_allow:
      - lp_em_cc2340r5moda
      - lp_em_cc2340r53
      - lp_em_cc2340r53_wcsp
      - lp_em_cc2745r10_q1/cc2745r10_q1
      - lp_em_cc2745r10_q1/cc2755r10
      - lp_em_cc2755p10
      - lp_em_cc2755p20
    tags: bluetooth
    harness: bluetooth
```

## tests/drivers/adc/adc_accuracy_test/testcase.yaml
```yaml
common:
  tags:
    - adc
    - drivers
  depends_on:
    - adc
tests:
  drivers.adc.accuracy.dac_source:
    depends_on:
      - dac
    harness_config:
      fixture: dac_adc_loopback
    platform_allow:
      - frdm_k64f
  drivers.adc.accuracy.ref_volt:
    harness_config:
      fixture: adc_ref_volt
    platform_allow:
      - frdm_kl25z
      - lp_em_cc2340r5
      - lp_em_cc2340r53
      - lp_em_cc2340r5moda
      - lp_em_cc2755p10
      - lp_em_cc2745r10_q1/cc2755r10
      - lp_em_cc2745r10_q1/cc2745r10_q1
      - lp_em_cc2755p20
```

## tests/drivers/flash/negative_tests/testcase.yaml
```yaml
common:
  tags:
    - drivers
    - flash
tests:
  drivers.flash.negative_tests:
    platform_allow:
      - nrf54l15pdk/nrf54l15/cpuapp
      - nrf54h20dk/nrf54h20/cpuapp
      - lp_em_cc35x1
      - lp_em_cc2340r5
      - lp_em_cc2340r5moda
      - lp_em_cc2340r53
      - lp_em_cc2340r53_wcsp
      - lp_em_cc2745r10_q1/cc2745r10_q1
      - lp_em_cc2745r10_q1/cc2755r10
      - lp_em_cc2755p10
```

## tests/drivers/gpio/gpio_hogs/testcase.yaml
```yaml
tests:
  drivers.gpio.hogs:
    tags:
      - drivers
      - gpio
    depends_on: gpio
    platform_allow:
      - native_sim
      - native_sim/native/64
      - frdm_k64f
      - nrf52840dk/nrf52840
      - nucleo_g474re
      - nrf52_bsim
      - mr_canhubk3
      - s32z2xxdc2/s32z270/rtu0
      - s32z2xxdc2/s32z270/rtu1
      - s32z2xxdc2@D/s32z270/rtu0
      - s32z2xxdc2@D/s32z270/rtu1
      - lp_em_cc35x1
      - lp_em_cc2340r5
      - lp_em_cc2340r53
      - lp_em_cc2755p10
      - lp_em_cc2745r10_q1/cc2745r10_q1
      - lp_em_cc2745r10_q1/cc2755r10
    integration_platforms:
      - native_sim
      - native_sim/native/64
```

## tests/drivers/i2c/i2c_lm75/testcase.yaml
```yaml
common:
  tags: drivers i2c
tests:
  drivers.i2c.tmp1075:
    filter: dt_compat_enabled("lm75")
    platform_allow: lp_em_cc35x1
```

## tests/drivers/i2s/i2s_api/testcase.yaml
```yaml
tests:
  drivers.i2s:
    depends_on: i2s
    tags:
      - drivers
      - userspace
    filter: not CONFIG_I2S_TEST_USE_GPIO_LOOPBACK
    platform_exclude:
      - mimxrt595_evk/mimxrt595s/cm33
      - mimxrt685_evk/mimxrt685s/cm33
  drivers.i2s.gpio_loopback:
    depends_on:
      - i2s
      - gpio
    tags:
      - drivers
      - userspace
    filter: CONFIG_I2S_TEST_USE_GPIO_LOOPBACK
    harness: ztest
    platform_exclude:
      - mimxrt595_evk/mimxrt595s/cm33
      - mimxrt685_evk/mimxrt685s/cm33
    harness_config:
      fixture: gpio_loopback
  drivers.i2s.gpio_loopback.left_justified:
    depends_on:
      - i2s
      - gpio
    tags:
      - drivers
      - userspace
    filter: CONFIG_I2S_TEST_USE_GPIO_LOOPBACK
    harness: ztest
    platform_allow:
      - lp_em_cc35x1
    harness_config:
      fixture: gpio_loopback
    extra_configs:
      - CONFIG_I2S_TEST_DATA_FORMAT_LJF=y
  drivers.i2s.gpio_loopback.right_justified:
    depends_on:
      - i2s
      - gpio
    tags:
      - drivers
      - userspace
    filter: CONFIG_I2S_TEST_USE_GPIO_LOOPBACK
    harness: ztest
    platform_allow:
      - lp_em_cc35x1
    harness_config:
      fixture: gpio_loopback
    extra_configs:
      - CONFIG_I2S_TEST_DATA_FORMAT_RJF=y
```

## tests/kernel/sched/schedule_api/testcase.yaml
```yaml
common:
  timeout: 180
  min_ram: 34
  tags:
    - kernel
    - threads
    - scheduler
    - userspace
  ignore_faults: true
tests:
  kernel.scheduler:
    filter: not CONFIG_SCHED_MULTIQ
    extra_configs:
      - CONFIG_TIMESLICING=y
  kernel.scheduler.no_timeslicing:
    filter: not CONFIG_SCHED_MULTIQ
    extra_configs:
      - CONFIG_TIMESLICING=n
  kernel.scheduler.slice_perthread:
    filter: not CONFIG_SCHED_MULTIQ
    platform_exclude:
      # Currently LPF3 devices are configured to tick rates higher than the
      # test support
      - lp_em_cc2340r5
      - lp_em_cc2340r5moda
      - lp_em_cc2340r53
      - lp_em_cc2340r53_wcsp
      - lp_em_cc2745r10_q1/cc2745r10_q1
      - lp_em_cc2745r10_q1/cc2755r10_q1
      - lp_em_cc2755p10
    extra_configs:
      - CONFIG_TIMESLICING=y
      - CONFIG_TIMESLICE_PER_THREAD=y
  kernel.scheduler.multiq:
    extra_args: CONF_FILE=prj_multiq.conf
    extra_configs:
      - CONFIG_TIMESLICING=y
  kernel.scheduler.multiq_no_timeslicing:
    extra_args: CONF_FILE=prj_multiq.conf
    extra_configs:
      - CONFIG_TIMESLICING=n
  kernel.scheduler.dumb_timeslicing:
    extra_args: CONF_FILE=prj_dumb.conf
    extra_configs:
      - CONFIG_TIMESLICING=y
  kernel.scheduler.dumb_no_timeslicing:
    extra_args: CONF_FILE=prj_dumb.conf
    extra_configs:
      - CONFIG_TIMESLICING=n
```

## tests/kernel/sleep/testcase.yaml
```yaml
tests:
  kernel.common.timing:
    tags:
      - kernel
      - sleep
  kernel.common.timing.minimallibc:
    tags:
      - kernel
      - sleep
      - libc
    extra_configs:
      - CONFIG_MINIMAL_LIBC=y
```

## tests/kernel/timer/timer_api/testcase.yaml
```yaml
tests:
  kernel.timer:
    platform_exclude:
      # Currently LPF3 devices are configured to tick rates higher than the
      # tests support
      - lp_em_cc2340r5
      - lp_em_cc2340r53
      - lp_em_cc2745r10_q1/cc2745r10_q1
      - lp_em_cc2745r10_q1/cc2755r10_q1
      - lp_em_cc2755p10
    tags:
      - kernel
      - timer
      - userspace
  kernel.timer.no_multitheading:
    tags:
      - kernel
      - timer
    platform_allow:
      - qemu_cortex_m3
      - nsim/nsim_em
      - nsim/nsim_em7d_v22
      - nsim/nsim_hs
      - nsim/nsim_hs/mpuv6
      - nsim/nsim_hs5x
      - nsim/nsim_hs6x
      - qemu_arc/qemu_arc_em
      - qemu_arc/qemu_arc_hs
      - qemu_arc/qemu_arc_hs6x
      - qemu_leon3
    integration_platforms:
      - qemu_cortex_m3
      - nsim/nsim_em
    extra_configs:
      - CONFIG_MULTITHREADING=n
      - CONFIG_TEST_USERSPACE=n
      - CONFIG_SPIN_VALIDATE=n
```

## tests/kernel/timer/timer_behavior/testcase.yaml
```yaml
tests:
  kernel.timer.timer:
    platform_exclude:
      # Currently LPF3 devices are configured to tick rates higher than the
      # tests support
      - lp_em_cc2340r5
      - lp_em_cc2340r53
      - lp_em_cc2745r10_q1/cc2745r10_q1
      - lp_em_cc2745r10_q1/cc2755r10_q1
    tags:
      - kernel
      - timer
    min_ram: 16
    platform_type:
      - mcu
    simulation_exclude:
      - renode
    harness_config:
      record:
        regex: "RECORD:(?P<metrics>.*)"
        as_json: ['metrics']
  kernel.timer.timer_behavior_external:
    filter: dt_compat_enabled("test-kernel-timer-behavior-external")
    harness: pytest
    harness_config:
      pytest_args: ['--tool', 'saleae_logic2', '--tool-options',
                    'address=127.0.0.1,port=10430,channel=1,sample-rate=6_250_000,threshold-volts=3.3']
      fixture: gpio_timerout
      record:
        regex: "RECORD:(?P<metrics>.*)"
        as_json: ['metrics']
    extra_configs:
      - CONFIG_TIMER_EXTERNAL_TEST=y
      - CONFIG_BOOT_DELAY=5000
```

## tests/subsys/pm/power_mgmt_soc/testcase.yaml
```yaml
tests:
  pm.soc:
    platform_allow:
      - cc26x2r1_launchxl
      - cc1352r1_launchxl
      - lp_em_cc2340r5
      - lp_em_cc2340r5moda
      - lp_em_cc2340r53
      - lp_em_cc2340r53_wcsp
      - lp_em_cc2745r10_q1/cc2745r10_q1
      - lp_em_cc2745r10_q1/cc2755r10
      - lp_em_cc2755p10
      - mec15xxevb_assy6853
      - mec1501modular_assy6885
      - nucleo_f429zi
      - nucleo_wb55rg
      - nucleo_l476rg
      - twr_ke18f
      - mimxrt595_evk/mimxrt595s/cm33
      - rd_rw612_bga
    tags: pm
    integration_platforms:
      - mec15xxevb_assy6853
```
