## CMakeLists.txt
```
# SPDX-License-Identifier: Apache-2.0
cmake_minimum_required(VERSION 3.20.0)
find_package(Zephyr REQUIRED HINTS $ENV{ZEPHYR_BASE})
project(ti_cc140xp_rf_diagnostics)

add_compile_definitions(DUAL_RADIOS TRX_CC1407)

target_include_directories(app PRIVATE src)

target_sources(app PRIVATE
    src/main.c
    src/at/AtTerm.c
    src/at/AtProcess.c
    src/at/AtControl.c
    src/at/AtParams.c
    src/TestMode.c
    src/radio/radio_common.c
    src/radio/radio_builtin_stub.c
    src/radio/trx/radio_trx.c
    src/radio/trx/radio_trx_mdr.c
    src/radio/trx/PhySettings_trx.c
    src/radio/trx/PhySettings_trx_mdr.c
    src/settings/rcl_settings_2gfsk38p4kbps.c
    src/settings/rcl_settings_2gfsk50kbps.c
    src/settings/rcl_settings_2gfsk50kbps_lp.c
    src/settings/rcl_settings_2gfsk9p6kbps.c
    src/settings/rcl_settings_dualrx_sun_oqpsk_2gfsk38p4kbps.c
    src/settings/rcl_settings_general_purpose_gfsk.c
    src/settings/rcl_settings_ofdmlr_16p67ksps.c
    src/settings/rcl_settings_ofdmlr_66p67ksps.c
    src/settings/rcl_settings_ofdmlr_8p33ksps.c
    src/settings/rcl_settings_sunoqpsk.c
    src/settings/rcl_settings_wisun.c
    src/settings/rcl_settings_xlr_20ksps.c
    src/wisun/wisun_delta_tables_EU1.c
    src/wisun/wisun_delta_tables_JP.c
    src/wisun/wisun_delta_tables_NA.c
)
```

## sample.yaml
```
sample:
  name: TI CC140xP RF Diagnostics Sample
  description: Interactive AT-command RF diagnostics and certification tool for the TI CC140xP transceiver
common:
  tags:
    - drivers
    - prop_rf
    - shield
  depends_on: spi gpio
tests:
  sample.shields.ti_bp_cc140xp.ti_cc140xp_rf_diagnostics:
    harness: shield
    extra_args: SHIELD=ti_bp_cc140xp
    platform_allow:
      - lp_em_cc2745r10_q1/cc2745r10_q1
    integration_platforms:
      - lp_em_cc2745r10_q1/cc2745r10_q1
```

## prj.conf
```kconfig
CONFIG_SPI=y
CONFIG_GPIO=y
CONFIG_TI_CC140XP=y
CONFIG_REBOOT=y
CONFIG_SERIAL=y
CONFIG_CONSOLE=n
CONFIG_UART_CONSOLE=n
CONFIG_LOG=n
CONFIG_MAIN_STACK_SIZE=16384
CONFIG_HEAP_MEM_POOL_SIZE=32768
CONFIG_SYSTEM_WORKQUEUE_STACK_SIZE=2048
CONFIG_PM=y
```

## boards/lp_em_cc2745r10_q1_cc2745r10_q1.overlay
```dts
/*
 * Copyright (c) 2026 Texas Instruments Incorporated
 * SPDX-License-Identifier: Apache-2.0
 *
 * The ti_bp_cc140xp shield's LP-CC2745R10-Q1 board overlay defaults to
 * spi-max-frequency = 12000000, matching the other ti_cc140xp samples. This
 * sample runs at 8000000 instead - lowering it resolved intermittent SPI
 * transport errors during AT-command RF diagnostics testing (see the SPI
 * clock/VDDS threshold discussion earlier this session).
 */

&ti_bp_cc140xp_trx {
	spi-max-frequency = <8000000>;
};
```

## src/main.c
```c
/*
 * Copyright (c) 2026 Texas Instruments Incorporated
 * SPDX-License-Identifier: Apache-2.0
 */

#include <zephyr/device.h>
#include <zephyr/drivers/gpio.h>
#include <zephyr/kernel.h>

#include "at/AtProcess.h"
#include "at/AtTerm.h"
#include "radio/radio.h"

#if DT_NODE_HAS_STATUS(DT_ALIAS(led0), okay)
#define LED0_NODE DT_ALIAS(led0)
const struct gpio_dt_spec led0 = GPIO_DT_SPEC_GET(LED0_NODE, gpios);
#define HAS_LED0 1
#else
#define HAS_LED0 0
#endif

#if DT_NODE_HAS_STATUS(DT_ALIAS(led1), okay)
#define LED1_NODE DT_ALIAS(led1)
const struct gpio_dt_spec led1 = GPIO_DT_SPEC_GET(LED1_NODE, gpios);
#define HAS_LED1 1
#else
#define HAS_LED1 0
#endif

int main(void)
{
#if HAS_LED0
	gpio_pin_configure_dt(&led0, GPIO_OUTPUT_INACTIVE);
#endif
#if HAS_LED1
	gpio_pin_configure_dt(&led1, GPIO_OUTPUT_INACTIVE);
#endif

	AtTerm_init();
	AtTerm_clearTerm();
	AtTerm_sendString("RF Diagnostics Example\r\n");

	Radio_Init();

	while (1) {
		AtProcess_processingLoop();
	}

	return 0;
}
```

## src/TestMode.c
```c
/*
 * Copyright (c) 2026 Texas Instruments Incorporated
 * SPDX-License-Identifier: Apache-2.0
 *
 * Zephyr adaptation: removes radio/builtin/PhySettings.h and
 * DeviceFamily_constructPath includes (not used in function bodies).
 */
#include <stdlib.h>
#include <inttypes.h>
#include <string.h>
#include <stdbool.h>

#include "radio/radio.h"
#include "TestMode.h"

#if defined(DUAL_RADIOS)
static uint8_t currentMode[2] = {0};
#else
static uint8_t currentMode[1] = {0};
#endif

static printMsgFxn pTestMsgFxn;


static void TestMode_Exit(uint8_t testMode)
{
    if ((testMode == TestMode_MODULATED) || (testMode == TestMode_CARRIER_WAVE))
    {
        Radio_cancelTx();
    }
    else // TestMode_PER_RX or TestMode_CONT_RX
    {
        Radio_cancelRx();

        if(testMode == TestMode_PER_RX)
        {
            int8_t rssiMin = Radio_getMinRssi();
            int8_t rssiMax = Radio_getMaxRssi();
            int32_t rssiAvg = Radio_getAvgRssi();
            uint16_t packetCount = Radio_getNumRxPackets();
            uint16_t packetCountNok = Radio_getNumRxPacketsNok();
            uint16_t rxSyncCount = Radio_getNumRxSync();
            uint8_t rxPhyId = Radio_getRxPhyIndex();
            char *phyName = Radio_getPhyName(rxPhyId);

            pTestMsgFxn(TestMode_EXIT, packetCount, packetCountNok, rxSyncCount, false, rssiAvg, (int32_t)(rssiMin), (int32_t)(rssiMax), phyName);
        }
        else if(testMode == TestMode_MDR_RX)
        {
            int8_t rssiMin = Radio_getMinRssi();
            int8_t rssiMax = Radio_getMaxRssi();
            int32_t rssiAvg = Radio_getAvgRssi();
            uint16_t packetCount = Radio_getNumRxPackets();
            uint16_t packetCountNok = Radio_getNumRxPacketsNok();
            uint16_t rxSyncCount = Radio_getNumRxSync();
            uint8_t rxPhyId = Radio_getRxPhyIndex();
            char *phyName = Radio_getPhyName(rxPhyId);

            pTestMsgFxn(TestMode_EXIT, packetCount, packetCountNok, rxSyncCount, false, rssiAvg, (int32_t)(rssiMin), (int32_t)(rssiMax), phyName);
        }
    }
}

void TestMode_perTxPrintMsg(uint16_t numPackets)
{
    pTestMsgFxn(TestMode_PER_TX, numPackets, 0, 0, false, 0, 0, 0, NULL);
}

uint8_t TestMode_read(void)
{
    return currentMode[Radio_getCurrentRadio()-1U];
}


TestMode_Status TestMode_write(uint32_t newMode, uint32_t perNumPkts, uint32_t perPktLen, printMsgFxn pMsgFxn)
{
    TestMode_Status status = TestMode_Status_Fail;
    pTestMsgFxn = pMsgFxn;

    uint8_t *currentRadioTestMode = &currentMode[Radio_getCurrentRadio()-1U];

    if(newMode < TestMode_NUMBER_OF_MODES)
    {
        //------------------------------------------------------------------------------------------
        // TestMode_CARRIER_WAVE
        //------------------------------------------------------------------------------------------
        if((*currentRadioTestMode == TestMode_EXIT) && (newMode == TestMode_CARRIER_WAVE))
        {
            // Call function to transmit CW
            if (Radio_contTx(TestMode_SELECT_CW))
            {
                *currentRadioTestMode = newMode;
                status = TestMode_Status_Success;
            }
            else
            {
                status = TestMode_Status_Fail;
            }
        }

        //------------------------------------------------------------------------------------------
        // TEST_MODE_MODULATED
        //------------------------------------------------------------------------------------------
        else if((*currentRadioTestMode == TestMode_EXIT) && (newMode == TestMode_MODULATED))
        {
            // Call function to transmit modulated
            if (Radio_contTx(TestMode_SELECT_MODULATED))
            {
                *currentRadioTestMode = newMode;
                status = TestMode_Status_Success;
            }
            else
            {
                status = TestMode_Status_Fail;
            }
        }

        //------------------------------------------------------------------------------------------
        // TEST_MODE_CONT_RX
        //------------------------------------------------------------------------------------------
        else if((*currentRadioTestMode == TestMode_EXIT) && (newMode == TestMode_CONT_RX))
        {
            // Call function to enter continuous RX
            if (Radio_contRx())
            {
                *currentRadioTestMode = newMode;
                status = TestMode_Status_Success;
            }
            else
            {
                status = TestMode_Status_Fail;
            }
        }

        //------------------------------------------------------------------------------------------
        // TEST_MODE_PER_TX
        //------------------------------------------------------------------------------------------
        else if((*currentRadioTestMode == TestMode_EXIT) && (newMode == TestMode_PER_TX))
        {
            // Start Transmitting perNumPkts packets of length perPktLen
            if (Radio_packetTx((uint16_t)perNumPkts, &perPktLen))
            {
                // Set test mode back to 0 when returning
                *currentRadioTestMode = TestMode_EXIT;
                status = TestMode_Status_Success;
            }
            else
            {
                status = TestMode_Status_Fail;
            }

            pTestMsgFxn(TestMode_PER_TX, 0, 0, 0, true, 0, 0, 0, NULL);
        }

        //------------------------------------------------------------------------------------------
        // TEST_MODE_PER_RX
        //------------------------------------------------------------------------------------------
        else if((*currentRadioTestMode == TestMode_EXIT) && (newMode == TestMode_PER_RX))
        {
            // Start PacketRx
            if (Radio_packetRx((uint16_t)perPktLen))
            {
                *currentRadioTestMode = TestMode_PER_RX;
                status = TestMode_Status_Success;
                pTestMsgFxn(TestMode_PER_RX, 0, 0, 0, false, 0, 0, 0, NULL);
            }
            else
            {
                status = TestMode_Status_Fail;
            }

        }

        //------------------------------------------------------------------------------------------
        // TEST_MODE_MDR_TX
        //------------------------------------------------------------------------------------------
        else if((*currentRadioTestMode == TestMode_EXIT) && (newMode == TestMode_MDR_TX))
        {
            // Start Transmitting perNumPkts packets of length perPktLen
            if (Radio_packetMdrTx((uint16_t)perNumPkts, &perPktLen))
            {
                // Set test mode back to 0 when returning
                *currentRadioTestMode = TestMode_EXIT;
                status = TestMode_Status_Success;
            }
            else
            {
                status = TestMode_Status_Fail;
            }

            pTestMsgFxn(TestMode_MDR_TX, 0, 0, 0, true, 0, 0, 0, NULL);
        }

        //------------------------------------------------------------------------------------------
        // TEST_MODE_MDR_RX
        //------------------------------------------------------------------------------------------
        else if((*currentRadioTestMode == TestMode_EXIT) && (newMode == TestMode_MDR_RX))
        {
            // Start PacketRx
            if (Radio_packetMdrRx((uint16_t)perPktLen))
            {
                *currentRadioTestMode = TestMode_MDR_RX;
                status = TestMode_Status_Success;
                pTestMsgFxn(TestMode_MDR_RX, 0, 0, 0, false, 0, 0, 0, NULL);
            }
            else
            {
                status = TestMode_Status_Fail;
            }

        }

        //------------------------------------------------------------------------------------------
        // TEST_MODE_MDR_CS_TX
        //------------------------------------------------------------------------------------------
        else if((*currentRadioTestMode == TestMode_EXIT) && (newMode == TestMode_MDR_CS_TX))
        {
            // Start Transmitting perNumPkts packets of length perPktLen
            if (Radio_packetMdrCsTx((uint16_t)perNumPkts, &perPktLen))
            {
                // Set test mode back to 0 when returning
                *currentRadioTestMode = TestMode_EXIT;
                status = TestMode_Status_Success;
            }
            else
            {
                status = TestMode_Status_Fail;
            }

            pTestMsgFxn(TestMode_MDR_CS_TX, 0, 0, 0, true, 0, 0, 0, NULL);
        }

        //------------------------------------------------------------------------------------------
        // TEST_MODE_CS_TX
        //------------------------------------------------------------------------------------------
        else if((*currentRadioTestMode == TestMode_EXIT) && (newMode == TestMode_CS_TX))
        {
            // Start Transmitting perNumPkts packets of length perPktLen
            if (Radio_packetCsTx((uint16_t)perNumPkts, &perPktLen))
            {
                // Set test mode back to 0 when returning
                *currentRadioTestMode = TestMode_EXIT;
                status = TestMode_Status_Success;
            }
            else
            {
                status = TestMode_Status_Fail;
            }

            pTestMsgFxn(TestMode_CS_TX, 0, 0, 0, true, 0, 0, 0, NULL);
        }

        //------------------------------------------------------------------------------------------
        // EXIT_TEST_MODE
        //------------------------------------------------------------------------------------------
        else if(((*currentRadioTestMode == TestMode_CARRIER_WAVE) ||
                 (*currentRadioTestMode == TestMode_MODULATED)    ||
                 (*currentRadioTestMode == TestMode_PER_RX)       ||
                 (*currentRadioTestMode == TestMode_MDR_RX)       ||
                 (*currentRadioTestMode == TestMode_CONT_RX))     &&
                 (newMode == TestMode_EXIT))
        {
            // Function to abort the different modes
            TestMode_Exit(*currentRadioTestMode);

            *currentRadioTestMode = TestMode_EXIT;
            status = TestMode_Status_Success;
        }
        else
        {
            status = TestMode_Status_Fail;
        }
    }
    return status;
}
```

## src/TestMode.h
```c
/*
 * Copyright (c) 2015-2022, Texas Instruments Incorporated
 * All rights reserved.
 *
 * Redistribution and use in source and binary forms, with or without
 * modification, are permitted provided that the following conditions
 * are met:
 *
 * *  Redistributions of source code must retain the above copyright
 *    notice, this list of conditions and the following disclaimer.
 *
 * *  Redistributions in binary form must reproduce the above copyright
 *    notice, this list of conditions and the following disclaimer in the
 *    documentation and/or other materials provided with the distribution.
 *
 * *  Neither the name of Texas Instruments Incorporated nor the names of
 *    its contributors may be used to endorse or promote products derived
 *    from this software without specific prior written permission.
 *
 * THIS SOFTWARE IS PROVIDED BY THE COPYRIGHT HOLDERS AND CONTRIBUTORS "AS IS"
 * AND ANY EXPRESS OR IMPLIED WARRANTIES, INCLUDING, BUT NOT LIMITED TO,
 * THE IMPLIED WARRANTIES OF MERCHANTABILITY AND FITNESS FOR A PARTICULAR
 * PURPOSE ARE DISCLAIMED. IN NO EVENT SHALL THE COPYRIGHT OWNER OR
 * CONTRIBUTORS BE LIABLE FOR ANY DIRECT, INDIRECT, INCIDENTAL, SPECIAL,
 * EXEMPLARY, OR CONSEQUENTIAL DAMAGES (INCLUDING, BUT NOT LIMITED TO,
 * PROCUREMENT OF SUBSTITUTE GOODS OR SERVICES; LOSS OF USE, DATA, OR PROFITS;
 * OR BUSINESS INTERRUPTION) HOWEVER CAUSED AND ON ANY THEORY OF LIABILITY,
 * WHETHER IN CONTRACT, STRICT LIABILITY, OR TORT (INCLUDING NEGLIGENCE OR
 * OTHERWISE) ARISING IN ANY WAY OUT OF THE USE OF THIS SOFTWARE,
 * EVEN IF ADVISED OF THE POSSIBILITY OF SUCH DAMAGE.
 */
#ifndef TestMode__include
#define TestMode__include

/***************************************************************************************************
 * DEFINES
 ***************************************************************************************************/
#define TestMode_EXIT               0
#define TestMode_CARRIER_WAVE       1
#define TestMode_MODULATED          2
#define TestMode_CONT_RX            3
#define TestMode_PER_TX             4
#define TestMode_PER_RX             5
#define TestMode_MDR_TX             6
#define TestMode_MDR_RX             7
#define TestMode_MDR_CS_TX          8
#define TestMode_CS_TX              9
#define TestMode_NUMBER_OF_MODES    10

#define TestMode_SELECT_CW                 1
#define TestMode_SELECT_MODULATED          0

// Test status
typedef enum
{
    TestMode_Status_Fail                = 0,
    TestMode_Status_Success             = 1,
} TestMode_Status;

// Function type to print messages
typedef void (*printMsgFxn)(uint32_t mode, uint16_t packetCount, uint16_t packetCountNok, uint16_t rxSyncCount, bool txDone, int32_t avgRssi, int32_t minRssi, int32_t maxRssi, char *phyName);

/***************************************************************************************************
 *
 * Runs/exits a test mode
 *
 * This function runs or exits a specified test mode
 *
 * param newMode     - The test mode to set and run
 * param perNumPkts  - Number of PER packets for PER TX or PER RX test modes
 * param perPktLen   - PER packet length for PER TX or PER RX test modes
 * param pMsgFxn     - Pointer to print function
 *
 *return Status of setting test mode
 *
 ***************************************************************************************************/
TestMode_Status TestMode_write(uint32_t newMode, uint32_t perNumPkts, uint32_t perPktLen, printMsgFxn pMsgFxn);

/***************************************************************************************************
 *
 * Prints the number of transmitted packets
 *
 * param numPackets - Number of transmitted packets
 *
 * return none
 *
 ***************************************************************************************************/
void TestMode_perTxPrintMsg(uint16_t numPackets);

/***************************************************************************************************
 *
 * Get the active test mode
 *
 * param none
 *
 * return active test mode
 *
 ***************************************************************************************************/
uint8_t TestMode_read(void);

#endif /* TestMode__include */
```
