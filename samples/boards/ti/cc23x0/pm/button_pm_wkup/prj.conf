## prj.conf
```kconfig
CONFIG_GPIO=y
CONFIG_GPIO_GET_CONFIG=y
CONFIG_GPIO_GET_DIRECTION=y

# CONFIG_DEBUG=y
# CONFIG_DEBUG_INFO=y
# CONFIG_NO_OPTIMIZATIONS=y

CONFIG_LOG=y
CONFIG_LOG_BUFFER_SIZE=4096
CONFIG_LOG_MODE_IMMEDIATE=y
CONFIG_LOG_PROCESS_THREAD=y
CONFIG_LOG_PRINTK=y
CONFIG_KERNEL_LOG_LEVEL_DBG=y
CONFIG_THREAD_NAME=y

# CONFIG_DMA=y
# CONFIG_DMA_LOG_LEVEL_DBG=y

CONFIG_PM=y
CONFIG_PM_DEVICE=y
CONFIG_PM_DEVICE_SYSTEM_MANAGED=y

# CONFIG_DEVICE_SHELL=y
# CONFIG_PM_DEVICE_SHELL=y

CONFIG_IDLE_STACK_SIZE=4096
```

## src/main.c
```c
/*
 * Copyright (c) Baylibre SAS
 *
 * SPDX-License-Identifier: Apache-2.0
 */

#include <zephyr/kernel.h>
#include <zephyr/device.h>
#include <zephyr/drivers/gpio.h>
#include <zephyr/sys/util.h>
#include <zephyr/sys/printk.h>
#include <inttypes.h>

#define SLEEP_TIME_MS	10000000

/*
 * Get button configuration from the devicetree sw0 alias. This is mandatory.
 */
#define SW0_NODE	DT_ALIAS(sw0)
#if !DT_NODE_HAS_STATUS(SW0_NODE, okay)
#error "Unsupported board: sw0 devicetree alias is not defined"
#endif
static const struct gpio_dt_spec button = GPIO_DT_SPEC_GET_OR(SW0_NODE, gpios,
							      {0});
static struct gpio_callback button_cb_data;

/*
 * The led0 devicetree alias is optional. If present, we'll use it
 * to turn on the LED whenever the button is pressed.
 */
static struct gpio_dt_spec led = GPIO_DT_SPEC_GET_OR(DT_ALIAS(led0), gpios,
						     {0});

void button_pressed(const struct device *dev, struct gpio_callback *cb,
		    uint32_t pins)
{
	printk("Button pressed at %" PRIu32 "\n", k_cycle_get_32());
	gpio_pin_set_dt(&led, 1);
	while (gpio_pin_get_dt(&button));
	gpio_pin_set_dt(&led, 0);
}
int booster_pack_gpios[] = {9, 10, 14, 15};

#define GPIO_NODE	DT_NODELABEL(gpio0)

const struct device *dev = DEVICE_DT_GET(GPIO_NODE);;

#define CHECK_MODE(_flags, _x) #_x, _flags&_x?"YES":"NO"

void print_gpio(uint32_t pin, uint32_t flags) {
	printk("PIN [%d]\n", pin);
	printk(" %20.20s\t[%3.3s]\n", CHECK_MODE(flags, GPIO_INPUT));
	printk(" %20.20s\t[%3.3s]\n", CHECK_MODE(flags, GPIO_OUTPUT));
	printk(" %20.20s\t[%3.3s]\n", CHECK_MODE(flags, GPIO_OUTPUT_INIT_HIGH));
	printk(" %20.20s\t[%3.3s]\n", CHECK_MODE(flags, GPIO_OUTPUT_INIT_LOW));
	printk(" %20.20s\t[%3.3s]\n", CHECK_MODE(flags, GPIO_PULL_UP));
	printk(" %20.20s\t[%3.3s]\n", CHECK_MODE(flags, GPIO_PULL_DOWN));
	printk(" %20.20s\t[%3.3s]\n", CHECK_MODE(flags, GPIO_INT_EDGE_RISING));
	printk(" %20.20s\t[%3.3s]\n", CHECK_MODE(flags, GPIO_INT_EDGE_FALLING));
	printk(" %20.20s\t[%3.3s]\n", CHECK_MODE(flags, GPIO_INT_DISABLE));
	printk(" %20.20s\t[%3.3s]\n", CHECK_MODE(flags, GPIO_OPEN_SOURCE));
}

int main(void)
{
	int ret;

	if (!gpio_is_ready_dt(&button)) {
		printk("Error: button device %s is not ready\n",
		       button.port->name);
		return 0;
	}

	ret = gpio_pin_configure_dt(&button, GPIO_INPUT | GPIO_INT_WAKEUP);
	if (ret != 0) {
		printk("Error %d: failed to configure %s pin %d\n",
		       ret, button.port->name, button.pin);
		return 0;
	}

	ret = gpio_pin_interrupt_configure_dt(&button, GPIO_INT_EDGE_TO_ACTIVE);
	if (ret != 0) {
		printk("Error %d: failed to configure interrupt on %s pin %d\n",
			ret, button.port->name, button.pin);
		return 0;
	}

	gpio_init_callback(&button_cb_data, button_pressed, BIT(button.pin));
	gpio_add_callback(button.port, &button_cb_data);
	printk("Set up button at %s pin %d\n", button.port->name, button.pin);

	if (led.port && !gpio_is_ready_dt(&led)) {
		printk("Error %d: LED device %s is not ready; ignoring it\n",
		       ret, led.port->name);
		led.port = NULL;
	}
	if (led.port) {
		ret = gpio_pin_configure_dt(&led, GPIO_OUTPUT);
		if (ret != 0) {
			printk("Error %d: failed to configure LED device %s pin %d\n",
			       ret, led.port->name, led.pin);
			led.port = NULL;
		} else {
			printk("Set up LED at %s pin %d\n", led.port->name, led.pin);
		}
	}

	uint32_t flags = 0;

	for (int i = 0 ; i < (sizeof(booster_pack_gpios) / sizeof(int)) ; i++) {
		ret = gpio_pin_get_config(dev, booster_pack_gpios[i], &flags);
		if (ret != 0) {
			printk("Error %d: failed to configure %d\n", ret, booster_pack_gpios[i]);
			return 0;
		} else {
			print_gpio(booster_pack_gpios[i], flags);
		}
	}

	printk("Press the button\n");
	if (led.port) {
		while (1) {
			k_msleep(SLEEP_TIME_MS);
		}
	}
	return 0;
}
```
